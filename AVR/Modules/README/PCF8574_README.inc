// ДАННЫЙ МОДУЛЬ НАПИСАН ДЛЯ работы с чипом 8 битного расширения портов по I2C

// Работа модуля
/*
* Модуль работает только вместе с модулем TWSI (I2C)
* -----------------------------------------------------------------------------------------------
* 
* Запись в порты
* Перед тем как записывать регистр в чип, необходимо их подготовить.
* Записать значение в регистр (r16 например) и передать аргументом
* Байт будет на ножках Р07-Р00
* .. PCF8574Write [аргумент1], [аргумент2] ..
* [аргумент1] адрес_устройства ($04 - например), смотрите по DATASHEET
* [аргумент2] регистр со значением
*
* -----------------------------------------------------------------------------------------------
* 
* Чтение из порта производится в память по адресу, переданному в аргументе
* Байт будет на ножках Р07-Р00
* .. PCF8574Read [аргумент1], [аргумент2] ..
* [аргумент1] адрес_устройства ($04 - например), смотрите по DATASHEET
* [аргумент2] метка адреса в памяти куда писать байт
*
* -----------------------------------------------------------------------------------------------
*/
