// ДАННЫЙ МОДУЛЬ НАПИСАН ДЛЯ настройки и работы внешних прерываний по пинам

// Настройки модуля
/*
* Все настройки выполняются в файле (ExtInt_Config.inc) в папке Modules/Configs
* -----------------------------------------------------------------------------------------------
* Включает один из пинов INT и устанавливает режим его работы
* 
* .. ExtInterINTEnable [аргумент1], [аргумент2] ..
* [аргумент1] принимает значение INT0...INT7
* [аргумент2] принимает значение [LowLevel], [AnyEdge], [FallingEdge] или [RisingEdge]
*
* -----------------------------------------------------------------------------------------------
* Выключает один из пинов INT
*
* .. ExtInterINTDisable [аргумент] ..
* [аргумент] принимает значение INT0...INT7
* -----------------------------------------------------------------------------------------------
* Включает или выключает прерывание по изменению состояния одного из пинов PCINT
*
* .. ExtInterPins [аргумент1], [аргумент2] ..
* [аргумент1] принимает значение PCINT0...PCINT31
* [аргумент2] принимает значение [enabled] или [disabled]  
* -----------------------------------------------------------------------------------------------
*/
