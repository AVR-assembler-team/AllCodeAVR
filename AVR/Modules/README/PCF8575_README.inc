// ДАННЫЙ МОДУЛЬ НАПИСАН ДЛЯ работы с чипом 16 битного расширения портов по I2C

// Работа модуля
/*
* Модуль работает только вместе с модулем TWSI (I2C)
* -----------------------------------------------------------------------------------------------
* 
* Запись в порты
* Перед тем как записывать регистры в чип, необходимо их подготовить.
* Эта команда читает два байта из памяти по адресу (PCF8575_2_bytes)
* Первый байт будет на ножках Р07-Р00
* Второй байт будет на ножках Р17-Р10
* .. PCF8575Write [аргумент1] ..
* [аргумент1] адрес_устройства ($04 - например), смотрите по DATASHEET
*
* -----------------------------------------------------------------------------------------------
* Выбор режима работы USART
*
* asynchron по умолчанию
*
* .. USARTModeSelect [аргумент1], [аргумент2] ..
* [аргумент1] принимает значение номера USART (0...3) (если только один, то ставим 0)
* [аргумент2] принимает значение [asynchron],[synchron] или [masterSPI]   
*
* -----------------------------------------------------------------------------------------------
* Выбор режима равенства USART
