// ДАННЫЙ МОДУЛЬ НАПИСАН ДЛЯ настройки и работы с таймерами контроллера

// Настройки модуля
/*
* Для правильной настройки таймера под ваш проект
* Все данные смотрите в DataSheet к вашему контроллеру
*
* ******************************************************************************************
* ******************************************************************************************
* ------------------------------------------------------------------------------------------
* ------------------------------------------------------------------------------------------
* Для настройки отдельного параметра счетчика во время работы можете использовать
* отдельные команды ниже
* ******************************************************************************************
* ------------------------------------------------------------------------------------------
* ------------------------------------------------------------------------------------------
* Для настройки претделителя используем 
* CountersPrescaller [аргумент1], [аргумент2]
* [аргумент1] - номер счетчика		Counter0 - Counter5
* [аргумент2] - претделитель		Prescaller1, Prescaller8, Prescaller32, Prescaller64, 
*									Prescaller128, Prescaller256, Prescaller1024
*
* Данная команда включит счетчик и настроит ваш претделитель
* ******************************************************************************************
* Табличка ниже показывает сколько микросекунд будет в одном бите регистра счетчика при 
* Определенной тактовой частоте и определенном претделителе
* ******************************************************************************************
*							Тактовая частота в Гц
* Prescaller	|| 16000000 | 8000000 | 4000000 | 2000000 | 1000000 |
* ------------------------------------------------------------------
*			1	|| 0.0625	| 0.125   | 0.25	| 0.5     | 1		|
* ------------------------------------------------------------------
*			8	|| 0.5		| 1		  | 2		| 4		  |	8		|
* ------------------------------------------------------------------
*			32	|| 2	    | 4		  | 8	    | 16	  | 32	    |
* ------------------------------------------------------------------
*			64	|| 4	    | 8		  |	16	    | 32	  |	64	    |
* ------------------------------------------------------------------
*			128	|| 8	    | 16	  |	32	    | 64	  |	128	    |
* ------------------------------------------------------------------
*			256	|| 16	    | 32	  |	64	    | 128	  |	256	    |
* ------------------------------------------------------------------
*			1024|| 64	    | 128	  |	256	    | 512	  |	1024    |
* ------------------------------------------------------------------
* ******************************************************************************************
* ------------------------------------------------------------------------------------------
* ------------------------------------------------------------------------------------------
* Для включения или отключения прерывания по переполнению или по совпадению используем
* CountersInterrupt [аргумент1], [аргумент2], [аргумент3], [аргумент4]
* [аргумент1] - номер счетчика	Counter0 - Counter5
* [аргумент2] - прерывание 
*				CaptureEvent	- по возникновению событияна ножке ICF
*				Overflow		- по переполнению регистра счетчика
*				CompareMatch	- по совпадению с проверочным регистром
*				CompareMatchA	- по совпадению с проверочным регистром А
*				CompareMatchB	- по совпадению с проверочным регистром В
*				CompareMatchС	- по совпадению с проверочным регистром C
* [аргумент3] - enabled или disabled (если disabled, то аргумент4 не обязателен)
* [аргумент4] - число для записи в регистр сравнения
* ******************************************************************************************
* ------------------------------------------------------------------------------------------
* ------------------------------------------------------------------------------------------
* Для настройки Waveform Generation Mode используем
* CountersWaveformGenerationMode [аргумент1], [аргумент2]
* [аргумент1] - номер счетчика	Counter0 - Counter5
* [аргумент2] - номер WaveForm Mode (смотрите в DataSheet на свой контроллер)
*				
* ******************************************************************************************
* ------------------------------------------------------------------------------------------
* ------------------------------------------------------------------------------------------
* Для настройки Compare Output Mode используем
* CountersCompareOutputMode [аргумент1], [аргумент2], [аргумент3]
* [аргумент1] - номер счетчика	Counter0 - Counter5
* [аргумент2] - CompareMatchOutput, CompareMatchOutputA, CompareMatchOutputB, CompareMatchOutputC
* [аргумент3] - номер режима от 0 до 3 (смотрите в DataSheet на свой контроллер)
* 
* ******************************************************************************************
* ------------------------------------------------------------------------------------------
* ------------------------------------------------------------------------------------------
* Для настройки внешнего источника на пин T0 для счетчика используем
* CountersExternalClockSourceOnT0pin [аргумент1], [аргумент2]
* [аргумент1] - номер счетчика	Counter0 - Counter5
* [аргумент2] - FallingEdge, RisingEdge
* 
* Данная команда включит счетчик, скинет претделитель на 1 и начнет считать изменения 
* на пине Т0
* ******************************************************************************************
* ------------------------------------------------------------------------------------------
* ------------------------------------------------------------------------------------------
* Для отключения счетчика без сброса настроек используем 
* CountersOffMode [аргумент1]
* [аргумент1] - номер счетчика	Counter0 - Counter5
*
*/ 
