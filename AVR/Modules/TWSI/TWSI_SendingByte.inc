/*
* Передача байта модулю TWSI
* Принимает один аргумент - регистр с данными для отправки модулю TWSI
*/
.macro TWSI_Sending_byte
	push r16
	mov r16, @0
	_call TWSI_Sending_byte_act
	TWSI_Status MT_DATA_ACK				; Проверяем получен ли ответ
	pop r16
.endm
//____________________________________________________________________________________
//____________________________________________________________________________________
TWSI_Sending_byte_act:
	WRITE_REG TWDR, r16						; вталкиваем в дата регистр
	TWSI_NACK_act:							; подпрограмма передает NAC
		ldi		r16, (1<<TWINT) | (1<<TWEN)	; формируем сигнал для передачи данных с TWDR
		WRITE_REG TWCR, r16					; отправляем по шине
		TWSI_TWINT_Flag
ret											; выход из подпрограммы
 