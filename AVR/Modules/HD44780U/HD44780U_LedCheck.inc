/*
* Проверка состояния подсветки из сохраненного состояния
* для дальнейшей работы по модулю TWI
*/
.macro HD44780U_led_check

	push r19						; вталкиваем r19 в STACK
	push r20						; вталкиваем r20 в STACK

	ldi r19, @0						; записывам @0 в r19
	ldi r20, @1 					; записывам @1 в r20

	_call HD44780U_led_check_act	; переходим
		
	pop r20							; выталкиваем r20 из STACK
	pop r19							; выталкиваем r19 из STACK

.endm
//____________________________________________________________________________________
//____________________________________________________________________________________
HD44780U_led_check_act:

	push r17						; вталкиваем r17 в STACK

	READ_REG HD44780U_flags, r17	; записываем данные флага в r17

	sbrs r17, HD44780U_LCD_LIGHT
		or r16, r19					; логическое ИЛИ
	sbrc r17, HD44780U_LCD_LIGHT
		or r16, r20					; логическое ИЛИ

	pop r17							; выталкиваем r17 из STACK

ret
