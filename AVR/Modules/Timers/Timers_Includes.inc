.include "Modules/Timers/Timers_Constants.inc"

.include "Modules/Timers/Prescaller/Timers_Prescaller_Counter_0.inc"
.include "Modules/Timers/Prescaller/Timers_Prescaller_Counter_1.inc"
.include "Modules/Timers/Prescaller/Timers_Prescaller_Counter_2.inc"
.include "Modules/Timers/Prescaller/Timers_Prescaller_Counter_3.inc"
.include "Modules/Timers/Prescaller/Timers_Prescaller_Counter_4.inc"
.include "Modules/Timers/Prescaller/Timers_Prescaller_Counter_5.inc"

.include "Modules/Timers/Counter/Timers_Counter_0.inc"
.include "Modules/Timers/Counter/Timers_Counter_1.inc"
.include "Modules/Timers/Counter/Timers_Counter_2.inc"
.include "Modules/Timers/Counter/Timers_Counter_3.inc"
.include "Modules/Timers/Counter/Timers_Counter_4.inc"
.include "Modules/Timers/Counter/Timers_Counter_5.inc"

.include "Modules/Timers/Timers_Sets.inc"
