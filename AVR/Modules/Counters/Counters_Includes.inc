.include "Modules/Counters/Counters_Constants.inc"

.include "Modules/Counters/Prescaller/Counter_0.inc"
.include "Modules/Counters/Prescaller/Counter_1.inc"
.include "Modules/Counters/Prescaller/Counter_2.inc"
.include "Modules/Counters/Prescaller/Counter_3.inc"
.include "Modules/Counters/Prescaller/Counter_4.inc"
.include "Modules/Counters/Prescaller/Counter_5.inc"
.include "Modules/Counters/Prescaller/Prescaller.inc"

.include "Modules/Counters/Interrupt/Counter_0.inc"
.include "Modules/Counters/Interrupt/Counter_1.inc"
.include "Modules/Counters/Interrupt/Counter_2.inc"
.include "Modules/Counters/Interrupt/Counter_3.inc"
.include "Modules/Counters/Interrupt/Counter_4.inc"
.include "Modules/Counters/Interrupt/Counter_5.inc"
.include "Modules/Counters/Interrupt/Interrupt.inc"

.include "Modules/Counters/WeveformGenerationMode/Counter_0.inc"
.include "Modules/Counters/WeveformGenerationMode/Counter_1.inc"
.include "Modules/Counters/WeveformGenerationMode/Counter_2.inc"
.include "Modules/Counters/WeveformGenerationMode/Counter_3.inc"
.include "Modules/Counters/WeveformGenerationMode/Counter_4.inc"
.include "Modules/Counters/WeveformGenerationMode/Counter_5.inc"
.include "Modules/Counters/WeveformGenerationMode/Weveform_Generation_Mode.inc"

.include "Modules/Counters/CompareOutputMode/Counter_0.inc"
.include "Modules/Counters/CompareOutputMode/Counter_1.inc"
.include "Modules/Counters/CompareOutputMode/Counter_2.inc"
.include "Modules/Counters/CompareOutputMode/Counter_3.inc"
.include "Modules/Counters/CompareOutputMode/Counter_4.inc"
.include "Modules/Counters/CompareOutputMode/Counter_5.inc"
.include "Modules/Counters/CompareOutputMode/Compare_Output_Mode.inc"

.include "Modules/Counters/ExternalClockSourceOnT0pin/Counter_0.inc"
.include "Modules/Counters/ExternalClockSourceOnT0pin/Counter_1.inc"
.include "Modules/Counters/ExternalClockSourceOnT0pin/Counter_2.inc"
.include "Modules/Counters/ExternalClockSourceOnT0pin/Counter_3.inc"
.include "Modules/Counters/ExternalClockSourceOnT0pin/Counter_4.inc"
.include "Modules/Counters/ExternalClockSourceOnT0pin/Counter_5.inc"
.include "Modules/Counters/ExternalClockSourceOnT0pin/External_Clock_Source_On_T0_pin.inc"

.include "Modules/Counters/OffMode/Counter_0.inc"
.include "Modules/Counters/OffMode/Counter_1.inc"
.include "Modules/Counters/OffMode/Counter_2.inc"
.include "Modules/Counters/OffMode/Counter_3.inc"
.include "Modules/Counters/OffMode/Counter_4.inc"
.include "Modules/Counters/OffMode/Counter_5.inc"
.include "Modules/Counters/OffMode/OffMode.inc"


