.macro CountersWeveformGenerationModeCounter5
	.if @0 == 0
		CLRB TCCR5A, WGM50
		CLRB TCCR5A, WGM51
		CLRB TCCR5B, WGM52
		CLRB TCCR5B, WGM53
	.elif @0 == 1
		SETB TCCR5A, WGM50
		CLRB TCCR5A, WGM51
		CLRB TCCR5B, WGM52
		CLRB TCCR5B, WGM53
	.elif @0 == 2
		CLRB TCCR5A, WGM50
		SETB TCCR5A, WGM51
		CLRB TCCR5B, WGM52
		CLRB TCCR5B, WGM53
	.elif @0 == 3
		SETB TCCR5A, WGM50
		SETB TCCR5A, WGM51
		CLRB TCCR5B, WGM52
		CLRB TCCR5B, WGM53
	.elif @0 == 4
		CLRB TCCR5A, WGM50
		CLRB TCCR5A, WGM51
		SETB TCCR5B, WGM52
		CLRB TCCR5B, WGM53
	.elif @0 == 5
		SETB TCCR5A, WGM50
		CLRB TCCR5A, WGM51
		SETB TCCR5B, WGM52
		CLRB TCCR5B, WGM53
	.elif @0 == 6
		CLRB TCCR5A, WGM50
		SETB TCCR5A, WGM51
		SETB TCCR5B, WGM52
		CLRB TCCR5B, WGM53
	.elif @0 == 7
		SETB TCCR5A, WGM50
		SETB TCCR5A, WGM51
		SETB TCCR5B, WGM52
		CLRB TCCR5B, WGM53
	.elif @0 == 8
		CLRB TCCR5A, WGM50
		CLRB TCCR5A, WGM51
		CLRB TCCR5B, WGM52
		SETB TCCR5B, WGM53
	.elif @0 == 9
		SETB TCCR5A, WGM50
		CLRB TCCR5A, WGM51
		CLRB TCCR5B, WGM52
		SETB TCCR5B, WGM53
	.elif @0 == 10
		CLRB TCCR5A, WGM50
		SETB TCCR5A, WGM51
		CLRB TCCR5B, WGM52
		SETB TCCR5B, WGM53
	.elif @0 == 11
		SETB TCCR5A, WGM50
		SETB TCCR5A, WGM51
		CLRB TCCR5B, WGM52
		SETB TCCR5B, WGM53
	.elif @0 == 12
		CLRB TCCR5A, WGM50
		CLRB TCCR5A, WGM51
		SETB TCCR5B, WGM52
		SETB TCCR5B, WGM53
	.elif @0 == 13
		.error "This Mode Number is reserved for this controller!"
	.elif @0 == 14
		CLRB TCCR5A, WGM50
		SETB TCCR5A, WGM51
		SETB TCCR5B, WGM52
		SETB TCCR5B, WGM53
	.elif @0 == 15
		SETB TCCR5A, WGM50
		SETB TCCR5A, WGM51
		SETB TCCR5B, WGM52
		SETB TCCR5B, WGM53
	.else
		.error "This Mode Number is not supporting by this controller!"
	.endif
.endm
