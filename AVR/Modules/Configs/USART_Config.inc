//=========================================================================================
//=========================================================================================
//-----------------------------------------------------------------------------------------
; Прерывания по окончанию приема и передачи байта данных можно инициализировать тут,
; а можно влючить и отключить тогда, когда это необходимо в процессе выполнения программы.
; Подробно узнаете из файла README.inc в папке README 
//-----------------------------------------------------------------------------------------
//-----------------------------------------------------------------------------------------
; USART0 или если один USART в микроконтроллере

; Clock Polarity (used for Synchronous mode only, 0 as default)
//#define ClockPolarity0_1
    
//-----------------------------------------------------------------------------------------
//-----------------------------------------------------------------------------------------

; USART1

; Clock Polarity (used for Synchronous mode only, 0 as default)
//#define ClockPolarity1_1

//-----------------------------------------------------------------------------------------
//-----------------------------------------------------------------------------------------

; USART2

; Clock Polarity (used for Synchronous mode only, 0 as default)
//#define ClockPolarity2_1

//-----------------------------------------------------------------------------------------
//-----------------------------------------------------------------------------------------

; USART3

; Clock Polarity (used for Synchronous mode only, 0 as default)
//#define ClockPolarity3_1

//-----------------------------------------------------------------------------------------
//-----------------------------------------------------------------------------------------
 