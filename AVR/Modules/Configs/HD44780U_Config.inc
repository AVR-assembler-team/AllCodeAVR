; Выбор типа подключения
//#define HD44780U_8_Wires				; подключение микроконтроллера по 8-ми битам
//#define HD44780U_4_Wires				; подключение микроконтроллера по 4-м битам
#define HD44780U_TWSI					; подключение через TWSI переходник по 8-ми битам

// Настройки параметров работы дисплея
;------------------------------------------------------------
; Настройка (I/D) - Address Increment или Decrement
#define HD44780U_ID_Increment
//#define HD44780U_ID_Decrement
;------------------------------------------------------------
; Настройка (D) - дисплей включен или выключен
#define HD44780U_Display_On
//#define HD44780U_Display_Off
;------------------------------------------------------------
; Настройка (C) - курсор виден или нет
#define HD44780U_Cursor_On
//#define HD44780U_Cursor_Off
;------------------------------------------------------------
; Настройка (B) - курсор мигает или нет
#define HD44780U_Cursor_Blinking_On
//#define HD44780U_Cursor_Blinking_Off
;------------------------------------------------------------
; Настройка (S/C) - Display Shift или Cursor Move
//#define HD44780U_Display_Shift
#define HD44780U_Cursor_Move
;------------------------------------------------------------
; Настройка (R/L) - Shift to the right или Shift to the left
#define HD44780U_Shift_to_the_Right
//#define HD44780U_Shift_to_the_Left
;------------------------------------------------------------
; Настройка (N) - количество линий дисплея
#define Character_Front_5x8
//#define Character_Front_5x10
;------------------------------------------------------------
; LCD size
//#define HD44780U_LCD_2x16
#define HD44780U_LCD_Size_4x20
//____________________________________________________________________________________

// Ноги для подключения
// Меняйте значения у тех ног, которые используете
// остальный можно не коментировать

HD44780U_RSpin		'B', 0	; Нога для инструкции или данных
HD44780U_RWpin		'D', 2	; Нога записи или чтения
HD44780U_Epin		'D', 3	; Нога активации записи или чтения
HD44780U_LIGHTpin	'D', 4	; Нога (+) подсветки экрана

HD44780U_D0pin		'C', 0
HD44780U_D1pin		'C', 1
HD44780U_D2pin		'C', 2
HD44780U_D3pin		'C', 3
HD44780U_D4pin		'C', 4
HD44780U_D5pin		'C', 5
HD44780U_D6pin		'D', 6
HD44780U_D7pin		'D', 7
//____________________________________________________________________________________

// Для TWSI, адрес TWI девайса
HD44780U_SLA_Address	$70

