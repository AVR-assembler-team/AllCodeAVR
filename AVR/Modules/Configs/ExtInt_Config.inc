
; INT0
//#define _INT0_
; INT0 Sense Control (The low level of INT0 generates an interrupt request as default)
//#define _AnyEdge_INT0_
//define _FallingEdge_INT0_
//#define _RisingEdge_INT0_

; INT1
//#define _INT1_
; #define _AnyEdge_INT1_
//#define _FallingEdge_INT1_
//#define _RisingEdge_INT1_

; INT2
//#define _INT2_
; INT2 (The low level of INT2 generates an interrupt request as default)
//#define _AnyEdge_INT2_
//#define _FallingEdge_INT2_
//#define _RisingEdge_INT2_

; INT3
//#define _INT3_
; INT3 (The low level of INT3 generates an interrupt request as default)
//#define _AnyEdge_INT3_
//#define _FallingEdge_INT3_
//#define _RisingEdge_INT3_

; INT4
//#define _INT4_
; INT4 (The low level of INT4 generates an interrupt request as default)
//#define _AnyEdge_INT4_
//#define _FallingEdge_INT4_
//#define _RisingEdge_INT4_

; INT5
//#define _INT5_
; INT5 (The low level of INT5 generates an interrupt request as default)
//#define _AnyEdge_INT5_
//#define _FallingEdge_INT5_
//#define _RisingEdge_INT5_

; INT6
//#define _INT6_
; INT6 (The low level of INT6 generates an interrupt request as default)
//#define _AnyEdge_INT6_
//#define _FallingEdge_INT6_
//#define _RisingEdge_INT6_

; INT7
//#define _INT7_
; INT7 (The low level of INT7 generates an interrupt request as default)
//#define _AnyEdge_INT7_
//#define _FallingEdge_INT7_
//#define _RisingEdge_INT7_

; Pins
//#define EnablePCINT0
//#define EnablePCINT1
//#define EnablePCINT2
//#define EnablePCINT3
//#define EnablePCINT4
//#define EnablePCINT5
//#define EnablePCINT6
//#define EnablePCINT7
//#define EnablePCINT8
//#define EnablePCINT9
//#define EnablePCINT10
//#define EnablePCINT11
//#define EnablePCINT12
//#define EnablePCINT13
//#define EnablePCINT14
//#define EnablePCINT15
//#define EnablePCINT16
//#define EnablePCINT17
//#define EnablePCINT18
//#define EnablePCINT19
//#define EnablePCINT20
//#define EnablePCINT21
//#define EnablePCINT22
//#define EnablePCINT23
//#define EnablePCINT24
//#define EnablePCINT25
//#define EnablePCINT26
//#define EnablePCINT27
//#define EnablePCINT28
//#define EnablePCINT29
//#define EnablePCINT30
//#define EnablePCINT31
