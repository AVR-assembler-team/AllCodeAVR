// ДАННЫЙ МОДУЛЬ НАПИСАН ДЛЯ работы с чипом 16 битного расширения портов по I2C

// Работа модуля
/*
* Модуль работает только вместе с модулем TWSI (I2C). Включите его в файле AVRModules_Config.inc
* в папке Configs
* Обязательно смотрите какие регистры используют команды и если вы используете эти
* регистры, то используйте стек для сохранения данных ваших регистров
* -----------------------------------------------------------------------------------------------
* 
* Запись в порты
* Перед тем как записывать регистры в чип, необходимо их подготовить.
* Записать значение в память по адресу 
* PCF8575Bytes		-	первый байт
* PCF8575Bytes + 1	-	второй байт
* Первый байт будет на ножках Р07-Р00
* Второй байт будет на ножках Р17-Р10
* PCF8575Write [аргумент1]												(использует r23, r24, r25)
* [аргумент1] адрес_устройства ($04 - например), смотрите по DATASHEET
*
* -----------------------------------------------------------------------------------------------
* 
* Чтение из портов производится в память по адресу, переданному в аргументах
* Первый байт будет на ножках Р07-Р00
* Второй байт будет на ножках Р17-Р10
* PCF8575Read [аргумент1]												(использует r23, r24, r25)
* [аргумент1] адрес_устройства ($04 - например), смотрите по DATASHEET
* Данные будут записаны в память по адресу
* PCF8575Bytes		-	первый байт
* PCF8575Bytes + 1	-	второй байт 
*
* -----------------------------------------------------------------------------------------------
*/
