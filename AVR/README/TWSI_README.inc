// ДАННЫЙ МОДУЛЬ НАПИСАН ДЛЯ работы по протоколу Two wires (TWSI)

// Настройки модуля
/*
* Все настройки выполняются в файле (TWSI_Config.inc) в папке Configs
* Обязательно смотрите какие регистры используют команды и если вы используете эти
* регистры, то используйте стек для сохранения данных ваших регистров
* -----------------------------------------------------------------------------------------------
*  
* Отправляем байт (если запись)
* 1- TWSI_START													(использует r25)
* 2- TWSI_SLA [аргумент1], [аргумент2]							(использует r23, r24, r25)
*			[аргумент1]	-	адрес_устройства ($04 - например)
*			[аргумент2]	-	Запись ('W')
*	После всего этого в регистре TWSI_Flags если флаг No_ACK поднят, то ответ от устройства не пришел
* 3- записываем данные в регистр TWDR
* 4- TWSI_Byte_Transmit											(использует r23, r24, r25)
* 5- TWSI_ACK_Check MT_DATA_ACK, MT_DATA_NOT_ACK		; Проверяем получен ли ответ
*	После всего этого в регистре TWSI_Flags если флаг No_ACK поднят, то ответ от устройства не пришел
*	Если нужно отправлять еще данные, то повторяем пункты 3, 4 и 5
* 5- TWSI_STOP													(использует r25)								
* =================================================================================================
*
* Читаем байт (если чтение)
* 1- TWSI_START													(использует r25)
* 2- TWSI_SLA [аргумент1], [аргумент2]							(использует r23, r24, r25)
*			[аргумент1]	-	адрес_устройства ($04 - например)
*			[аргумент2]	-	Чтение ('R')
*	После всего этого в регистре TWSI_Flags если флаг No_ACK поднят, то ответ от устройства не пришел
* 3- TWSI_ACK_Transmit											(использует r25)
* 4- читаем данные из регистра TWDR
*	Если будем читать не один байт, то для каждого следующего повторяем пункты 3 и 4
* 5- TWSI_Byte_Transmit											(использует r23, r24, r25)
* 6- TWSI_STOP													(использует r25)
*/
