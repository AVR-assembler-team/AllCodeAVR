// ДАННЫЙ МОДУЛЬ НАПИСАН ДЛЯ работы с чипом 8 битного расширения портов по I2C

// Работа модуля
/*
* Модуль работает только вместе с модулем TWSI (I2C). Включите его в файле AVRModules_Config.inc
* в папке Configs
* Обязательно смотрите какие регистры используют команды и если вы используете эти
* регистры, то используйте стек для сохранения данных ваших регистров
* -----------------------------------------------------------------------------------------------
* 
* Запись в порт
* Перед тем как записывать регистр в чип, необходимо его подготовить.
* Записать значение в память по адресу PCF8574Bytes
* Байт будет на ножках Р07-Р00
* PCF8574Write [аргумент1]												(использует r23, r24, r25)
* [аргумент1] адрес_устройства ($04 - например), смотрите по DATASHEET
*
* -----------------------------------------------------------------------------------------------
* 
* Чтение из порта производится в память по адресу PCF8574Bytes
* Байт будет на ножках Р07-Р00
* PCF8574Read [аргумент1]												(использует r23, r24, r25)
* [аргумент1] адрес_устройства ($04 - например), смотрите по DATASHEET
*
* -----------------------------------------------------------------------------------------------
*/
