// ДАННЫЙ МОДУЛЬ НАПИСАН ДЛЯ настройки и работы внешних прерываний по пинам

// Работа модуля
/*
* -----------------------------------------------------------------------------------------------
* Включает один из пинов INT и устанавливает режим его работы
* 
* .. Enable_INT_Interrupt [аргумент1], [аргумент2] ..
* [аргумент1] принимает значение INT0...INT7
* [аргумент2] принимает значение [LowLevel], [AnyEdge], [FallingEdge] или [RisingEdge]
*
* -----------------------------------------------------------------------------------------------
* Выключает один из пинов INT
*
* .. Disable_INT_Interrupt [аргумент] ..
* [аргумент] принимает значение INT0...INT7
* -----------------------------------------------------------------------------------------------
* Включает прерывание по изменению состояния одного из пинов PCINT
*
* .. Enable_PCINT [аргумент1] ..
* [аргумент1] принимает значение 0...31 
* -----------------------------------------------------------------------------------------------
* Выключает прерывание по изменению состояния одного из пинов PCINT
*
* .. Disable_PCINT [аргумент1] ..
* [аргумент1] принимает значение 0...31 
* -----------------------------------------------------------------------------------------------
*/
