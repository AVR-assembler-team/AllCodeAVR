// ДАННЫЙ МОДУЛЬ НАПИСАН ДЛЯ /// DS1820, DS18B20, DS18S20, DS1822 ///

// Настройки модуля
/*
* -ВАЖНО--ВАЖНО--ВАЖНО--ВАЖНО--ВАЖНО--ВАЖНО--ВАЖНО--ВАЖНО--ВАЖНО--ВАЖНО--ВАЖНО-
*
* Данный модуль работает только при активированном модуле CRC_Calculate_Module
* Его необходимо разкоментировать в Configs.inc
*
* --------------------------------------------------------------------------------------------------
* Все настройки выполняются в файле OneWire_Config.inc в папке Configs.
* --------------------------------------------------------------------------------------------------
* 
* .. OneWire_InitializationSequence .. - команда запускает работу шины и проверяет присутствие на 
* шине хотябы одного девайса. Если есть то в байте флагов (OneWireFlags) флаг
* (OneWireDeviceNotDetected) будет очищен. В случае если шина пустая, то данный флаг будет поднят
* и программа пройдет через метку (DeviceNotDetected) в файле (Labels.inc).
*
* ==================================================================================================
* ROM Commands
* ==================================================================================================
*
* .. OneWire_ReadROM .. - команда считывает 8 байт ROM код девайса и записывает в ОЗУ по метке
* (OneWireROMCode). Работает только в том случае, если девайс на шине один. Иначе используйте
* другую команду.
* В данную команду включена проверка CRC полученных данных и если данные получены с ошибкой,
* то в ОЗУ микроконтроллера по метке (OneWireROMCode) будут 8 нулей, в байте с флагами
* (OneWireFlags) будет поднят флаг (OneWireROMCodeCRCInvalid) и программа пройдет через метку
* (ROMCodeCRCError) в файле (OneWire_Labels.inc).
* 
* ||||||||||||||||||||||||||||||||||||||||||||||||||||||||||||||||||||||||||||||||||||||||||||||||||
*
* .. OneWire_MatchROM [аргумент] .. - обращается к девайсу по ROM коду, указанному в аргументе.
* [аргумент] - передаем имя метки из ОЗУ контроллера по адресу которой лежит ROM код девайса.
* А затем посылаем в шину функциональную команду (что устройство должно сделать)
* 
* ||||||||||||||||||||||||||||||||||||||||||||||||||||||||||||||||||||||||||||||||||||||||||||||||||
*
* .. OneWire_SearchROM .. - читает ROM коды всех девайсов на шине, которые висят без Alarm.
* В данную команду включена проверка CRC полученных данных и если данные получены с ошибкой,
* то в ОЗУ микроконтроллера по метке (OneWireROMCode) будут 8 нулей, в байте с флагами
* (OneWireFlags) будет поднят флаг (OneWireROMCodeCRCInvalid) и программа пройдет через метку
* (ROMCodeCRCError) в файле (Labels.inc).
* По завершении чтения каждого ROM кода, он будет храниться в ОЗУ по адресу (OneWireROMCode)
* и будет перезаписан при чтении следующего ROM кода на новый.
* Также при чтении каждного полного кода программа будет проскакивать через функцию (ROMCodeNormal)
* в файле (Labels.inc)
* 
* ||||||||||||||||||||||||||||||||||||||||||||||||||||||||||||||||||||||||||||||||||||||||||||||||||
*
* .. OneWire_AlarmSearch .. -читает ROM коды всех девайсов на шине, которые висят с Alarm.
* В данную команду включена проверка CRC полученных данных и если данные получены с ошибкой,
* то в ОЗУ микроконтроллера по метке (OneWireAlarmROMCode) будут 8 нулей, в байте с флагами
* (OneWireFlags) будет поднят флаг (OneWireROMCodeCRCInvalid) и программа пройдет через метку
* (ROMCodeCRCError) в файле (Labels.inc).
* По завершении чтения каждого ROM кода, он будет храниться в ОЗУ по адресу (OneWireAlarmROMCode)
* и будет перезаписан при чтении следующего ROM кода на новый.
* Также при чтении каждного полного кода программа будет проскакивать через функцию (ROMCodeAlarm)
* в файле (Labels.inc)
* 
* ||||||||||||||||||||||||||||||||||||||||||||||||||||||||||||||||||||||||||||||||||||||||||||||||||
*
* .. OneWire_SkipROM .. - пропускает ROM код и обращается ко всем устройствам на шине.
* 
* ||||||||||||||||||||||||||||||||||||||||||||||||||||||||||||||||||||||||||||||||||||||||||||||||||
*
* ==================================================================================================
* ==================================================================================================
* Function Commands (отсылаются сразу за ROM командами (OneWire_MatchROM) и (OneWire_SkipROM))
* ==================================================================================================
* 
* .. OneWire_ConvertTemperature .. - запускает процесс конвертации температуры внутри девайса.
* 
* ||||||||||||||||||||||||||||||||||||||||||||||||||||||||||||||||||||||||||||||||||||||||||||||||||
*
* .. OneWire_CopyScratchpad .. - сохраняет регистры TH, TL и Configuration в EEPROM и при включении
* девайса будут использоваться именно эти данные.
* 
* ||||||||||||||||||||||||||||||||||||||||||||||||||||||||||||||||||||||||||||||||||||||||||||||||||
*
* .. OneWire_PowerSupply .. - проверит какое питание использует девайс. Работает если девайс на шине
* один.
* Если девайс использует внешнее питание то в ОЗУ в байте флагов (OneWireFlags) будет поднят бит
* (OneWireExternalPower).
* 
* ||||||||||||||||||||||||||||||||||||||||||||||||||||||||||||||||||||||||||||||||||||||||||||||||||
*
* .. OneWire_ReadScratchpad .. - читает 9 байт scratch pad из девайса и сохраняет в ОЗУ по метке
* (OneWireScratchpad).
* В данную команду включена проверка CRC полученных данных и если данные получены с ошибкой,
* то в ОЗУ микроконтроллера по метке (OneWireScratchpad) будут 9 нулей, в байте с флагами
* (OneWireFlags) будет поднят флаг (OneWireROMCodeCRCInvalid) и программа пройдет через метку
* (ROMCodeCRCError) в файле (Labels.inc).
* 
* ||||||||||||||||||||||||||||||||||||||||||||||||||||||||||||||||||||||||||||||||||||||||||||||||||
*
* .. OneWire_Recall .. - перезапишет TH, TL и Configuration байты в памяти девайса, если девайс
* находился в Alarm.
* 
* ||||||||||||||||||||||||||||||||||||||||||||||||||||||||||||||||||||||||||||||||||||||||||||||||||
*
* .. OneWire_WriteScratchpad [аргумент] .. - запишет TH, TL и Configuration байты в памяти девайса.
* [аргумент] - число, указывающее сколько бит участвует в замере температуры (от 9 до 12).
* Влияет на точность измерения (знаков после запятой \от 1 до 4\).
* 
* ==================================================================================================
* ==================================================================================================
* Основные функции библиотеки, которыми вы можете пользоваться
* ==================================================================================================
*
*	Если девайс на шине один
* ---------------------------------
* .. OneWire_SingleDeviceTemperature .. - запускает процедуру конвертации температуры
* с последующим чтением Scratch pad в RAM контроллера по адресу OneWireScratchpad
* ---------------------------------
* .. OneWire_SingleDeviceTempPrepareToReading .. - запускает процедуру конвертации
* температуры и ожидает ее завершения
* ---------------------------------
* .. OneWire_SingleDeviceTempReadind .. - запускает процедуру чтения Scratch pad из
* устройства с его последующей записью в RAM контроллера по адресу OneWireScratchpad
|||||||||||||||||||||||||||||||||||||||||||||||||||||||||||||||||||||||||||||||||||||||||||||||||||
*
*	Если девайс на шине не один
* то в качестве [аргумент] используется метка в RAM контроллера на которой 
* находится 8 байт ROM кода девайса к которому вы хотите обратиться
* ---------------------------------
* .. OneWire_ROMDeviceTemperature [аргумент] .. - запускает процедуру конвертации температуры
* с последующим чтением Scratch pad в RAM контроллера по адресу OneWireScratchpad
* ---------------------------------
* .. OneWire_ROMDeviceTempPrepareToReading [аргумент] .. - запускает процедуру 
* конвертации температуры и ожидает ее завершения
* ---------------------------------
* .. OneWire_ROMDeviceTempTempReadind [аргумент] .. - запускает процедуру чтения 
* Scratch pad из устройства с его последующей записью в RAM контроллера по 
* адресу OneWireScratchpad
|||||||||||||||||||||||||||||||||||||||||||||||||||||||||||||||||||||||||||||||||||||||||||||||||||
*
* OneWire_TemperatureDataConvertation - берет данные из памяти контроллера с меткой
* OneWireScratchpad и преобразовывает в понятный для работы вид.
* После обработки данные температуры будут храниться в сегменте данных следующим образом:
*	- если температура отрицательная, то в байте с флагами (OneWireFlags) будет поднят
*		флаг (OneWireNegativeTemperature)
*	- если температура 100 и более градусов, то в байте с флагами (OneWireFlags) будет поднят
*		флаг (OneWireOneHundredDegrees)
*	- десятки градусов будут храниться по адресу (OneWireTemperature)
*		в первой тетраде первого байта
*	- градусы будут храниться по адресу (OneWireTemperature)
*		во второй тетраде первого байта
*	- десятые градуса будут храниться по адресу (OneWireTemperature)
*		в первой тетраде второго байта
*	- сотые градуса будут храниться по адресу (OneWireTemperature)
*		во второй тетраде второго байта
* |||||||||||||||||||||||||||||||||||||||||||||||||||||||||||||||||||||||||||||||||||||||||||||||||||
*
* ==================================================================================================
* ==================================================================================================
* Основные функции библиотеки, которыми вы можете пользоваться
* ==================================================================================================
* 
*/