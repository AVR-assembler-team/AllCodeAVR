// ДАННЫЙ МОДУЛЬ НАПИСАН ДЛЯ настройки и работы USART

// Настройки модуля
/*
* Все настройки выполняются в файле (USART_Config.inc) в папке Modules/Configs
* -----------------------------------------------------------------------------------------------
* Все настройки выполняются с помощью функций ниже
* Все функции прерываний лежат в Interrupts.inc
*
* -----------------------------------------------------------------------------------------------
* Скорость передачи данных USART (только для асинронного режима и 
* частот контроллера 1MHz, 2MHz, 4MHz, 8MHz, 16MHz)
* Если у вас другая скорость или режим работы, то смотрите формулу в DataSheet и расчитывайте сами.
*
* По умолчанию все USART имеют режим normal и скорость 9600 bps
*
* .. USARTBaudRate [аргумент1], [аргумент2], [аргумент3] ..
* [аргумент1] принимает значение номера USART (0...3) (если только один, то ставим 0)
* [аргумент2] нормальный режим или двойная скорость, принимает значения [normal] или [double]
* [аргумент3] принимает значение [Baud Rate [bps] из таблицы DataSheet]   
*	2400, 4800, 9600, 14400, 19200, 28800, 38400, 57600, 76800, 115200, 230400, 250000, 1000000
*
* -----------------------------------------------------------------------------------------------
* Выбор режима работы USART
*
* asynchron по умолчанию
*
* .. USARTModeSelect [аргумент1], [аргумент2] ..
* [аргумент1] принимает значение номера USART (0...3) (если только один, то ставим 0)
* [аргумент2] принимает значение [asynchron],[synchron] или [masterSPI]   
*
* -----------------------------------------------------------------------------------------------
* Выбор режима равенства USART
*
* disabled по умолчанию
*
* .. USARTParityMode [аргумент1], [аргумент2] ..
* [аргумент1] принимает значение номера USART (0...3) (если только один, то ставим 0)
* [аргумент2] принимает значение [disabled],[evenParity] или [oddParity]   
* 
* -----------------------------------------------------------------------------------------------
* Выбор количества бит приема и передачи по USART
*
* 8 bit по умолчанию
*
* .. USARTCharacterSize [аргумент1], [аргумент2] ..
* [аргумент1] принимает значение номера USART (0...3) (если только один, то ставим 0)
* [аргумент2] принимает значение [6], [7], [8] или [9]   
* 
* -----------------------------------------------------------------------------------------------
* Выбор количества стоп бит USART
*
* one по умолчанию
*
* .. USARTStopBits [аргумент1], [аргумент2] ..
* [аргумент1] принимает значение номера USART (0...3) (если только один, то ставим 0)
* [аргумент2] принимает значение [one] или [two]   
* 
* -----------------------------------------------------------------------------------------------
* Включение и выключение мультипроцессорного режима USART (читайте DataSheet)
*
* disabled по умолчанию
*
* .. USARTMultiProcessorCommunicationMode [аргумент1], [аргумент2] ..
* [аргумент1] принимает значение номера USART (0...3) (если только один, то ставим 0)
* [аргумент2] принимает значение [enabled] или [disabled]  
* 
* -----------------------------------------------------------------------------------------------
* Clock Polarity USART (читайте DataSheet)
*
* zero по умолчанию
*
* .. USARTClockPolarity [аргумент1], [аргумент2] ..
* [аргумент1] принимает значение номера USART (0...3) (если только один, то ставим 0)
* [аргумент2] принимает значение [zero] или [one]  
* 
* -----------------------------------------------------------------------------------------------
* Включение и выключение приемника 
*
* disabled по умолчанию
*
* .. USARTReceiver [аргумент1], [аргумент2] ..
* [аргумент1] принимает значение номера USART (0...3) (если только один, то ставим 0)
* [аргумент2] принимает значение [enabled] или [disabled]
* 
* -----------------------------------------------------------------------------------------------
* Включение и выключение передатчика 
*
* disabled по умолчанию
*
* .. USARTTransmitter [аргумент1], [аргумент2] ..
* [аргумент1] принимает значение номера USART (0...3) (если только один, то ставим 0)
* [аргумент2] принимает значение [enabled] или [disabled]
* 
* -----------------------------------------------------------------------------------------------
* Включение и выключение прерывания по окончанию приемы байта данных 
*
* disabled по умолчанию
*
* .. RXCompleteInterrupt [аргумент1], [аргумент2] ..
* [аргумент1] принимает значение номера USART (0...3) (если только один, то ставим 0)
* [аргумент2] принимает значение [enabled] или [disabled]
*
* -----------------------------------------------------------------------------------------------
* Включение и выключение прерывания по окончанию передачи байта данных 
*
* disabled по умолчанию
*
* .. TXCompleteInterrupt [аргумент1], [аргумент2] ..
* [аргумент1] принимает значение номера USART (0...3) (если только один, то ставим 0)
* [аргумент2] принимает значение [enabled] или [disabled]
*
* -----------------------------------------------------------------------------------------------
* Так как при инициализации UDR всегда пуст, по программа будет бесконечно проваливаться в
* прерывание USART_UDRE (0, 1, 2 или 3)
* Поэтому данные прерывания включаем только когда они нужны.
*
* disabled по умолчанию
*
*  .. USARTDataRegisterEmptyInterrupt [аргумент1], [аргумент2] ..
* [аргумент1] принимает значение номера USART (0...3) (если только один, то ставим 0)
* [аргумент2] принимает значение [enabled] или [disabled]
* 
* -----------------------------------------------------------------------------------------------
*/
