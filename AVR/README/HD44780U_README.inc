// ДАННЫЙ МОДУЛЬ НАПИСАН ДЛЯ ЧИПА /// HD44780U ///
// РАБОТАЕТ С 2-х СТРОЧНЫМИ И 4-х СТРОЧНЫМИ ДИСПЛЕЯМИ

/*
* Все настройки выполняются в файле (HD44780U_Config.inc) в папке Modules/Configs
* Инициализировать дисплей необходимо в ручную
* -------------------------------------------------------------------------------------------------------
* 1 - Выбираем тип подключения (Если используем подключение по TWSI, не забудьте подключить
*	  модуль для работы по TWSI)
* 2 - Настраиваем параметры работы дисплея
* 3 - Если используем подключение по TWSI, то указывайте адрес вашего TWSI девайса при вызовах
* ------------------------------------------------------------------------------------------------------------------
* Инициализировать дисплей
*		HD44780U_Init [аргумент1]
*	[аргумент1]	-	адресс устройства TWSI. Указывается только при его использовании
* ------------------------------------------------------------------------------------------------------------------
* Очистить дисплей						
* 		HD44780U_LCD_Clear [аргумент1]
*	[аргумент1]	-	адресс устройства TWSI. Указывается только при его использовании
* ------------------------------------------------------------------------------------------------------------------
* Установить положение курсора на дисплее
* 		HD44780U_Set_Cursor [аргумент1], [аргумент2], [аргумент3]
*	[аргумент1]	-	номер строки
*	[аргумент2]	-	номер позиции в строке
*	[аргумент3]	-	адресс устройства TWSI. Указывается только при его использовании
* ------------------------------------------------------------------------------------------------------------------
* Вывести символ на дисплей				
* 		HD44780U_Write_Symbol [аргумент1], [аргумент2]
*	[аргумент1]	-	символ в одинарных ковычках ('w' например)
*	[аргумент2]	-	адресс устройства TWSI. Указывается только при его использовании
* ------------------------------------------------------------------------------------------------------------------
* Вывести на дисплей значение из регистра
* 		HD44780U_Write_Register [аргумент1], [аргумент2]
*	[аргумент1]	-	любой доступный регистр от r16 до r31
*	[аргумент2]	-	адресс устройства TWSI. Указывается только при его использовании
* ------------------------------------------------------------------------------------------------------------------
* Вывести строку из програмного сегмента cseg памяти на дисплей			
* Сначала создаем строку в програмном скгменте с четным количеством байтов
* (если последний пустой, то заполняем его пробелом).
* В первом байте строки указываем сколько символов из строки выводим на экран.
* Далее со второго байта заполняем символами строки
* Пример:
*	.cseg
* 		message: .db 0x04, "Assy "
*		В строке message должно быть четное количество байтов, иначе ошибка. 
*		Если получается нечетное, то поставьте в конце пробел, как в примере
*		Вместо message можете использовать любое имя
* И выводим на экран командой
* 		HD44780U_Write_cseg_String [аргумент1], [аргумент2]
*	[аргумент1]	-	имя строки для вывода (message как в примере)
*	[аргумент2]	-	адресс устройства TWSI. Указывается только при его использовании
* ------------------------------------------------------------------------------------------------------------------
* 
* Вывести строку из памяти сегиента данных dseg на дисплей			
* Сначала создаем строку в сегиента данных. Заполняем ее в программе любым удобным способом
* В первом байте строки указываем сколько символов из строки выводим на экран.
* Далее со второго байта заполняем символами строки
* Пример:
*	.dseg
* 		message: .byte [количество байт строки]
*		Вместо message можете использовать любое имя
* И выводим на экран командой
* 		HD44780U_Write_dseg_String [аргумент1], [аргумент2]
*	[аргумент1]	-	имя строки для вывода (message как в примере)
*	[аргумент2]	-	адресс устройства TWSI. Указывается только при его использовании
* ------------------------------------------------------------------------------------------------------------------
* Включить или выключить мигание курсора
* 		HD44780U_Cursor_Blinking [аргумент1], [аргумент2]
*	[аргумент1]	-	On или Off
*	[аргумент2]	-	адресс устройства TWSI. Указывается только при его использовании
* ------------------------------------------------------------------------------------------------------------------
* Включить или выключить видимость курсора
* 		HD44780U_Cursor_visible [аргумент1], [аргумент2]
*	[аргумент1]	-	On или Off
*	[аргумент2]	-	адресс устройства TWSI. Указывается только при его использовании
* ------------------------------------------------------------------------------------------------------------------
* Включить или выключить подсветку дисплея
* 		HD44780U_LCD_LED [аргумент1], [аргумент2]
*	[аргумент1]	-	On или Off
*	[аргумент2]	-	адресс устройства TWSI. Указывается только при его использовании
* ------------------------------------------------------------------------------------------------------------------
* Переключить на сдвиг дисплея или сдвиг курсора
* 		HD44780U_Shift [аргумент1], [аргумент2]
*	[аргумент1]	-	HD44780U_Display - Сдвиг дисплея
*					HD44780U_Cursor  - Сдвиг курсора
*	[аргумент2]	-	адресс устройства TWSI. Указывается только при его использовании
* ------------------------------------------------------------------------------------------------------------------
* Переключить на сдвиг уменьшение или увеличение адреса DDRAM
* 		HD44780U_DDRAM_Address [аргумент1], [аргумент2]
*	[аргумент1]	-	HD44780U_ID_Increment - Увеличение адреса
*					HD44780U_ID_Decrement - Уменьшение адреса
*	[аргумент2]	-	адресс устройства TWSI. Указывается только при его использовании
*/ 
