// ДАННАЯ БИБЛИОТЕКА ВКЛЮЧАЕТ В СЕБЯ Макросы для упрощения программирования

// Настройки библиотеки
/*
	* STACKINIT				-	Инициализирует STACK
	* WDTOFF				-	Сбрасывает Watch Dog таймер
	* WRITE_BYTE port, byte	-	Выгрузка числа @1 в порт @0
	* WRITE_REG	port, reg	-	Вышрузка регистра @1 в порт @0
	* READ_REG	port, reg		-	Загрузка порта @0 в регистр @1
	* PUSHF / POPF			-	Сохранение/Восстановление регистров SREG и TEMP в Стеке.
	*								Примечание:
	*									Сохранение/Восстановление регистров SREG и TEMP в Стеке. 
	*									Данные макросы используются парно, обычно, в обработчиках прерываний.
	*									Портит содержимое регистра r16 на период обработки прерывания (между PUSHF..POPF)!
	*									Однако же, также и восстанавливает потом (после POPF)
	*									что делает регистр r16: "защищённой" доступной "временной переменной", внутри обработчика прерывания.
	* SETB byte, bit		-	Установить бит в порту
	* CLRB byte, bit		-	Очистить бит в порту
	* SETRB reg, bit		-	Установить бит в регистре
	* CLRRB reg, bit		-	Очистить бит в регистре
	* INVB byte, bit		-	Инвертировать бит 
	* STOREB byte, bit		-	Сохранить бит во флаг T регистра статуса (SREG)
	* LOADB byte, bit		-	Загрузить содержимое T флага регистра статуса (SREG) в бит регистра 
	* SETBM byte, bit		-	Установить бит в байте памяти via STACK/MEMORY
	* CLRBM byte, bit		-	Очистить бит в байте памяти via STACK/MEMORY
	* INVBM byte, bit		-	Инвертировать бит в байте памяти via STACK/MEMORY
	* STOREBM byte, bit		-	Сохранить бит во флаг T регистра статуса (SREG) via STACK/MEMORY
	* LOADBM byte, bit		-	Загрузить содержимое T флага регистра статуса (SREG) в бит регистра  via STACK/MEMORY
	* INC8M	byte			-	Инкрементация (+1) однойбайтной переменной @0 в памяти
	* DEC8M	byte			-	Декрементация (-1) однойбайтной переменной @0 в памяти
	* CLR8M	byte			-	Обнуление однобайтной переменной @0 в памяти
*/
