
;.equ TempRangeByteQuantity = 100
.equ TempRangeStep = 2		; шаг градусов в диапазоне
;.equ TempRangeMin = 0		; минимальная температура диапазона
.equ TempRangeMax = 100		; максимальная температура диапазона

TempRange: 
.dw $001c ; 0
.dw $001f ; 2
.dw $0023 ; 4
.dw $0026 ; 6
.dw $002a ; 8
.dw $002f ; 10
.dw $0033 ; 12
.dw $0038 ; 14
.dw $003e ; 16
.dw $0044 ; 18
.dw $004a ; 20
.dw $0051 ; 22
.dw $0058 ; 24
.dw $0060 ; 26
.dw $0068 ; 28
.dw $0071 ; 30
.dw $007a ; 32
.dw $0085 ; 34
.dw $008f ; 36
.dw $009a ; 38
.dw $00a6 ; 40
.dw $00b3 ; 42
.dw $00c0 ; 44
.dw $00ce ; 46
.dw $00dd ; 48
.dw $00ec ; 50
.dw $00fc ; 52
.dw $010d ; 54
.dw $011f ; 56
.dw $0131 ; 58
.dw $0144 ; 60
.dw $0158 ; 62
.dw $016c ; 64
.dw $0181 ; 66
.dw $0197 ; 68
.dw $01ad ; 70
.dw $01c4 ; 72
.dw $01dc ; 74
.dw $01f4 ; 76
.dw $020d ; 78
.dw $0226 ; 80
.dw $023f ; 82
.dw $0259 ; 84
.dw $0274 ; 86
.dw $028e ; 88
.dw $02a9 ; 90
.dw $02c5 ; 92
.dw $02e0 ; 94
.dw $02fc ; 96
.dw $0317 ; 98
.dw $0333 ; 100
