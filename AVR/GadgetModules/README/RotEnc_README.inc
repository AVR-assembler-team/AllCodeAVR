// ДАННЫЙ МОДУЛЬ НАПИСАН ДЛЯ РАБОТЫ С Rotary Encoder

// Настройки модуля
/*
* Все настройки выполняются в файле (RotEnc_Config.inc) в папке Modules/Configs
* -----------------------------------------------------------------------------------------------
* Модуль использует три пина.
* В файле настроек укажите какая ножна энкодера подсоединяется к какому пину контроллера
* Для правильной работы необходимо ножку А(CLK) соединять с пином, который будет 
* реагировать (проваливать контроллер в прерывание) или проверять состояние ножки по иному.
* Как только на ножке А сменится показание то необходимо запустить макрос (RotaryEncoderCount)
* который сделает все сам (увеличит показание или уменьшит на еденицу).
* Для простоты использования есть байт для хранения результата работы макроса энкодера, и 
* находится он в памяти по метке (RotaryEncoder_byte)
* Данный байт считает от 0 до 255 и не перезаписывается. Обнуляйте его или ставьте начальное значение
* для отчета своими ручками.
*
* Когда нажимаете на кнопку, то сигнал меняется на пине SW. Можете использовать прерывание или 
* проверять состояние кнопки по вашему усмотрению. Не забываем про дребезг контактов.
*
* Для работы с прерываниями по состоянию пина используйте модуль (ExtInterrupts_Module)
* Настройки данного модуля читайте в соответствующем README файле
*
*/