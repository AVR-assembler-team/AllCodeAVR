// ДАННЫЙ МОДУЛЬ НАПИСАН ДЛЯ работы с чипом 16 битного расширения портов по I2C

// Работа модуля
/*
* Модуль работает только вместе с модулем TWSI (I2C)
* -----------------------------------------------------------------------------------------------
* 
* Запись в порты
* Перед тем как записывать регистры в чип, необходимо их подготовить.
* Записать значение в регистры (r16 и r17 например) и передать аргументами
* Первый байт будет на ножках Р07-Р00
* Второй байт будет на ножках Р17-Р10
* .. PCF8575Write [аргумент1], [аргумент2], [аргумент3] ..
* [аргумент1] адрес_устройства ($04 - например), смотрите по DATASHEET
* [аргумент2] первый регистр со значением
* [аргумент3] второй регистр со значением
*
* -----------------------------------------------------------------------------------------------
* 
* Чтение из портов производится в память по адресу, переданному в аргументах
* Первый байт будет на ножках Р07-Р00
* Второй байт будет на ножках Р17-Р10
* .. PCF8575Read [аргумент1], [аргумент2], [аргумент3] ..
* [аргумент1] адрес_устройства ($04 - например), смотрите по DATASHEET
* [аргумент2] метка адреса в памяти куда писать первый байт
* [аргумент3] метка адреса в памяти куда писать второй байт
*
* -----------------------------------------------------------------------------------------------
*/
