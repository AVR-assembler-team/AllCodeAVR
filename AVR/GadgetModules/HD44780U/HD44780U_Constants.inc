/*
* Тут лежат все символические имена, используемые в библиотеке
* а также раздел .dseg с резервированный байтами в памяти
*/

.equ	HD44780U_LCDClear					=	$01		;очистка дисплея и установка курсора в первую ячейку первой строки
.equ	HD44780U_LCD_Home					=	$02		;установка курсора в первую ячейку первой строки
.equ	HD44780U_LCD_Entry_Mode_Set			=	$04		;установка направления перемещения курсора и сдвиг дисплея
.equ	HD44780U_Bit_I.D					=	1		;если 1-увеличение адреса DDRAM, 0-уменьшение адреса DDRAM
.equ	HD44780U_Bit_Shift_Display			=	0		;если 1-сдвиг дисплея, 0-сдвиг курсора
.equ	HD44780U_LCD_On_Off_Control			=	$08		;настройка дисплея
.equ	HD44780U_Bit_D						=	2		;если 1-дисплей включить, 0-дисплей выключить
.equ	HD44780U_Bit_C						=	1		;если 1-курсор виден, 0-не виден
.equ	HD44780U_Bit_B						=	0		;если 1-курсор мигает, 0-курсор не мигает
.equ    HD44780U_Cursor_or_Display_Shift	=	$10		;настройка движения дисплея или курсора
.equ    HD44780U_Bit_S.C					=	3		;если 1-сдвиг дисплей, 0-сдвиг курсора
.equ	HD44780U_Bit_R.L					=	2		;если 1-сдвиг вправо, 0-сдвиг влево
.equ	HD44780U_LCD_Function_Set			=	$20		;установки интерфейса
.equ	HD44780U_Bit_DL						=	4		;если 1-подключение по 8 бит, 0-по 4
.equ	HD44780U_Bit_N						=	3		;если 1-две линии в дисплее (4 строчки), 0-одна (2 строчки)
.equ	HD44780U_Bit_F						=	2		;если 1-буквы 5х10 точек, 0-5х8 точек

.equ	HD44780U_LCD_RS						=	0		;если 1-пересылаем данные, 0-инструкции
.equ	HD44780U_LCD_RW						=	1		;если 1-читаем, 0-пишем
.equ	HD44780U_LCD_E						=	2		;если 1-готовим данные на отправку, 0-отправляем
.equ	HD44780U_LCD_LIGHT					=	3		;если 1-то экран горит, 0-не горит
.equ	HD44780U_LCD_D4						=	4
.equ	HD44780U_LCD_D5						=	5
.equ	HD44780U_LCD_D6						=	6
.equ	HD44780U_LCD_D7						=	7

.dseg
	HD44780U_Function_Set_byte:				.byte 1		; для хранения состояния настройки
	HD44780U_Display_On_Off_Control_byte:	.byte 1		; для хранения состояния настройки
	HD44780U_Entry_Mode_Set_byte:			.byte 1		; для хранения состояния настройки
	HD44780U_Cursor_or_Display_Shift_byte:	.byte 1		; для хранения состояния настройки
	HD44780U_flags:							.byte 1		; для хранения разных данных
	HD44780U_Address_DDRAM:					.byte 1		; для хранения адреса DDRAM
.cseg

