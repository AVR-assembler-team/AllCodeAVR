// ДАННАЯ БИБЛИОТЕКА НАПИСАНА ДЛЯ настройки и работы Analog to Digital Converter

// Все настройки выполняются в соответствии с DataSheet на ваш контроллер.
// Макросы для настройки библиотеки
/* ========================================================================
* =========================================================================
* ADC Prescaler selection
*
* Работаем между 50kHz и 200kHz
* Делим ATmegaFREQ/50000 = претделитель на меньшую частоту
* Делим ATmegaFREQ/200000 = претделитель на большую частоту
* Выбираем между ними 
* бывает - 2, 4, 8, 16, 32, 64, 128
*
* Для настройки данного параметра используеется
*	ADCPrescalerSelection [аргумент1]
*	[аргумент1]	-	2, 4, 8, 16, 32, 64, 128
*
* =========================================================================
* =========================================================================
* ADC Input Channel Selection
*
* Для настройки данного параметра используеется
*	ADCInputChannelSelection [аргумент1], [аргумент2], [аргумент3], [аргумент4]
*	[аргумент1]	-	SingleEndedInput ([аргумент3], [аргумент4] не требуются), DifferentialInput
*	[аргумент2]	-	ADC0 - ADC15, VBG, GND ( зависит от вашего конироллера )
*	[аргумент3]	-	ADC0 - ADC15
*	[аргумент4]	-	Gain1, Gain10, Gain200 ( если ваш контроллер не поддерживает данный параметр,
*											то его можно не заполнять)
*
* =========================================================================
* =========================================================================
* ADC Digital Input Disable
*
* Для настройки данного параметра используется
*	ADCDigitalInputDisable [аргумент1]
*	[аргумент1]	-	pin0D - pin15D
*
* =========================================================================
* =========================================================================
* ADC Left Adjust Result
*
* Для настройки данного параметра используется
*	ADCLeftAdjustResult [аргумент1]
*	[аргумент1]	-	Left или Right
*
* =========================================================================
* =========================================================================
* ADC Auto Trigger Source
*
* Для настройки данного параметра используется
*	ADCAutoTriggerSourceSelections [аргумент1]
*	[аргумент1]	-	Null - Free Run Mode или ADC Auto Trigger Mode отключен
*					FreeRun - ADC Free Running Select или Free Running mode
*					AnComp - Analog Comparator
*					ExtIntReq0 - External Interrupt Request 0
*					TC0CompMatch - Timer/Counter0 Compare Match
*					TC0Overflow - Timer/Counter0 Overflow	
*					TC1CompMatchB - Timer/Counter1 Compare Match B
*					TC1Overflow - Timer/Counter1 Overflow
*					TC1CaptEvent - Timer/Counter1 Capture Event
*
* =========================================================================
* =========================================================================
*/
