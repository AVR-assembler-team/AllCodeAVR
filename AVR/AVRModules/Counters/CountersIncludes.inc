.include "AVRModules/Counters/CountersConstants.inc"

.include "AVRModules/Counters/Prescaller/Counter0.inc"
.include "AVRModules/Counters/Prescaller/Counter1.inc"
.include "AVRModules/Counters/Prescaller/Counter2.inc"
.include "AVRModules/Counters/Prescaller/Counter3.inc"
.include "AVRModules/Counters/Prescaller/Counter4.inc"
.include "AVRModules/Counters/Prescaller/Counter5.inc"
.include "AVRModules/Counters/Prescaller/CountersPrescaller.inc"

.include "AVRModules/Counters/Interrupt/Counter0.inc"
.include "AVRModules/Counters/Interrupt/Counter1.inc"
.include "AVRModules/Counters/Interrupt/Counter2.inc"
.include "AVRModules/Counters/Interrupt/Counter3.inc"
.include "AVRModules/Counters/Interrupt/Counter4.inc"
.include "AVRModules/Counters/Interrupt/Counter5.inc"
.include "AVRModules/Counters/Interrupt/CountersInterrupt.inc"

.include "AVRModules/Counters/WeveformGenerationMode/Counter0.inc"
.include "AVRModules/Counters/WeveformGenerationMode/Counter1.inc"
.include "AVRModules/Counters/WeveformGenerationMode/Counter2.inc"
.include "AVRModules/Counters/WeveformGenerationMode/Counter3.inc"
.include "AVRModules/Counters/WeveformGenerationMode/Counter4.inc"
.include "AVRModules/Counters/WeveformGenerationMode/Counter5.inc"
.include "AVRModules/Counters/WeveformGenerationMode/CountersWeveformGenerationMode.inc"

.include "AVRModules/Counters/CompareOutputMode/Counter0.inc"
.include "AVRModules/Counters/CompareOutputMode/Counter1.inc"
.include "AVRModules/Counters/CompareOutputMode/Counter2.inc"
.include "AVRModules/Counters/CompareOutputMode/Counter3.inc"
.include "AVRModules/Counters/CompareOutputMode/Counter4.inc"
.include "AVRModules/Counters/CompareOutputMode/Counter5.inc"
.include "AVRModules/Counters/CompareOutputMode/CountersCompareOutputMode.inc"

.include "AVRModules/Counters/ExternalClockSourceOnT0pin/Counter0.inc"
.include "AVRModules/Counters/ExternalClockSourceOnT0pin/Counter1.inc"
.include "AVRModules/Counters/ExternalClockSourceOnT0pin/Counter2.inc"
.include "AVRModules/Counters/ExternalClockSourceOnT0pin/Counter3.inc"
.include "AVRModules/Counters/ExternalClockSourceOnT0pin/Counter4.inc"
.include "AVRModules/Counters/ExternalClockSourceOnT0pin/Counter5.inc"
.include "AVRModules/Counters/ExternalClockSourceOnT0pin/CountersExternalClockSourceOnT0pin.inc"

.include "AVRModules/Counters/OffMode/Counter0.inc"
.include "AVRModules/Counters/OffMode/Counter1.inc"
.include "AVRModules/Counters/OffMode/Counter2.inc"
.include "AVRModules/Counters/OffMode/Counter3.inc"
.include "AVRModules/Counters/OffMode/Counter4.inc"
.include "AVRModules/Counters/OffMode/Counter5.inc"
.include "AVRModules/Counters/OffMode/CountersOffMode.inc"
