.macro CountersWeveformGenerationModeCounter3
	.if @0 == 0
		CLRB TCCR3A, WGM30
		CLRB TCCR3A, WGM31
		CLRB TCCR3B, WGM32
		CLRB TCCR3B, WGM33
	.elif @0 == 1
		SETB TCCR3A, WGM30
		CLRB TCCR3A, WGM31
		CLRB TCCR3B, WGM32
		CLRB TCCR3B, WGM33
	.elif @0 == 2
		CLRB TCCR3A, WGM30
		SETB TCCR3A, WGM31
		CLRB TCCR3B, WGM32
		CLRB TCCR3B, WGM33
	.elif @0 == 3
		SETB TCCR3A, WGM30
		SETB TCCR3A, WGM31
		CLRB TCCR3B, WGM32
		CLRB TCCR3B, WGM33
	.elif @0 == 4
		CLRB TCCR3A, WGM30
		CLRB TCCR3A, WGM31
		SETB TCCR3B, WGM32
		CLRB TCCR3B, WGM33
	.elif @0 == 5
		SETB TCCR3A, WGM30
		CLRB TCCR3A, WGM31
		SETB TCCR3B, WGM32
		CLRB TCCR3B, WGM33
	.elif @0 == 6
		CLRB TCCR3A, WGM30
		SETB TCCR3A, WGM31
		SETB TCCR3B, WGM32
		CLRB TCCR3B, WGM33
	.elif @0 == 7
		SETB TCCR3A, WGM30
		SETB TCCR3A, WGM31
		SETB TCCR3B, WGM32
		CLRB TCCR3B, WGM33
	.elif @0 == 8
		CLRB TCCR3A, WGM30
		CLRB TCCR3A, WGM31
		CLRB TCCR3B, WGM32
		SETB TCCR3B, WGM33
	.elif @0 == 9
		SETB TCCR3A, WGM30
		CLRB TCCR3A, WGM31
		CLRB TCCR3B, WGM32
		SETB TCCR3B, WGM33
	.elif @0 == 10
		CLRB TCCR3A, WGM30
		SETB TCCR3A, WGM31
		CLRB TCCR3B, WGM32
		SETB TCCR3B, WGM33
	.elif @0 == 11
		SETB TCCR3A, WGM30
		SETB TCCR3A, WGM31
		CLRB TCCR3B, WGM32
		SETB TCCR3B, WGM33
	.elif @0 == 12
		CLRB TCCR3A, WGM30
		CLRB TCCR3A, WGM31
		SETB TCCR3B, WGM32
		SETB TCCR3B, WGM33
	.elif @0 == 13
		.error "This Mode Number is reserved for this controller!"
	.elif @0 == 14
		CLRB TCCR3A, WGM30
		SETB TCCR3A, WGM31
		SETB TCCR3B, WGM32
		SETB TCCR3B, WGM33
	.elif @0 == 15
		SETB TCCR3A, WGM30
		SETB TCCR3A, WGM31
		SETB TCCR3B, WGM32
		SETB TCCR3B, WGM33
	.else
		.error "This Mode Number is not supporting by this controller!"
	.endif
.endm
