.include "AVRModules/Counters/Counters_Constants.inc"

.include "AVRModules/Counters/Prescaller/Counter_0.inc"
.include "AVRModules/Counters/Prescaller/Counter_1.inc"
.include "AVRModules/Counters/Prescaller/Counter_2.inc"
.include "AVRModules/Counters/Prescaller/Counter_3.inc"
.include "AVRModules/Counters/Prescaller/Counter_4.inc"
.include "AVRModules/Counters/Prescaller/Counter_5.inc"
.include "AVRModules/Counters/Prescaller/Prescaller.inc"

.include "AVRModules/Counters/Interrupt/Counter_0.inc"
.include "AVRModules/Counters/Interrupt/Counter_1.inc"
.include "AVRModules/Counters/Interrupt/Counter_2.inc"
.include "AVRModules/Counters/Interrupt/Counter_3.inc"
.include "AVRModules/Counters/Interrupt/Counter_4.inc"
.include "AVRModules/Counters/Interrupt/Counter_5.inc"
.include "AVRModules/Counters/Interrupt/Interrupt.inc"

.include "AVRModules/Counters/WeveformGenerationMode/Counter_0.inc"
.include "AVRModules/Counters/WeveformGenerationMode/Counter_1.inc"
.include "AVRModules/Counters/WeveformGenerationMode/Counter_2.inc"
.include "AVRModules/Counters/WeveformGenerationMode/Counter_3.inc"
.include "AVRModules/Counters/WeveformGenerationMode/Counter_4.inc"
.include "AVRModules/Counters/WeveformGenerationMode/Counter_5.inc"
.include "AVRModules/Counters/WeveformGenerationMode/WeveformGenerationMode.inc"

.include "AVRModules/Counters/CompareOutputMode/Counter_0.inc"
.include "AVRModules/Counters/CompareOutputMode/Counter_1.inc"
.include "AVRModules/Counters/CompareOutputMode/Counter_2.inc"
.include "AVRModules/Counters/CompareOutputMode/Counter_3.inc"
.include "AVRModules/Counters/CompareOutputMode/Counter_4.inc"
.include "AVRModules/Counters/CompareOutputMode/Counter_5.inc"
.include "AVRModules/Counters/CompareOutputMode/CompareOutputMode.inc"

.include "AVRModules/Counters/ExternalClockSourceOnT0pin/Counter_0.inc"
.include "AVRModules/Counters/ExternalClockSourceOnT0pin/Counter_1.inc"
.include "AVRModules/Counters/ExternalClockSourceOnT0pin/Counter_2.inc"
.include "AVRModules/Counters/ExternalClockSourceOnT0pin/Counter_3.inc"
.include "AVRModules/Counters/ExternalClockSourceOnT0pin/Counter_4.inc"
.include "AVRModules/Counters/ExternalClockSourceOnT0pin/Counter_5.inc"
.include "AVRModules/Counters/ExternalClockSourceOnT0pin/ExternalClockSourceOnT0pin.inc"

.include "AVRModules/Counters/OffMode/Counter_0.inc"
.include "AVRModules/Counters/OffMode/Counter_1.inc"
.include "AVRModules/Counters/OffMode/Counter_2.inc"
.include "AVRModules/Counters/OffMode/Counter_3.inc"
.include "AVRModules/Counters/OffMode/Counter_4.inc"
.include "AVRModules/Counters/OffMode/Counter_5.inc"
.include "AVRModules/Counters/OffMode/OffMode.inc"
