
.equ FreeRun			=	0
.equ AnComp				=	1
.equ ExtIntReq0			=	2
.equ TC0CompMatch		=	3
.equ TC0Overflow		=	4
.equ TC1CompMatchB		=	5
.equ TC1Overflow		=	6
.equ TC1CaptEvent		=	7
.equ SingleEndedInput	=	8
.equ DifferentialInput	=	9
.equ ADC0				=	10
.equ ADC1				=	11
.equ ADC2				=	12
.equ ADC3				=	13
.equ ADC4				=	14
.equ ADC5				=	15
.equ ADC6				=	16
.equ ADC7				=	17
.equ ADC8				=	18
.equ ADC9				=	19
.equ ADC10				=	20
.equ ADC11				=	21
.equ ADC12				=	22
.equ ADC13				=	23
.equ ADC14				=	24
.equ ADC15				=	25
.equ VBG				=	26
.equ V0					=	27
.equ V1					=	28
.equ Gain1				=	29
.equ Gain10				=	30
.equ Gain200			=	31
.equ pin0D				=	32
.equ pin1D				=	33
.equ pin2D				=	34
.equ pin3D				=	35
.equ pin4D				=	36
.equ pin5D				=	37
.equ pin6D				=	38
.equ pin7D				=	39
.equ pin8D				=	40
.equ pin9D				=	41
.equ pin10D				=	42
.equ pin11D				=	43
.equ pin12D				=	44
.equ pin13D				=	45
.equ pin14D				=	46
.equ pin15D				=	47
.equ AREFpin			=	48
.equ Internal_1_1V		=	49
.equ Internal_2_56V		=	50
