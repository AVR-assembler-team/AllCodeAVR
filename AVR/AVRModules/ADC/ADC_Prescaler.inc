.macro SetPrescaler
	#ifdef Prescaler_2
		SETB ADCSRA, ADPS0
		CLRB ADCSRA, ADPS1
		CLRB ADCSRA, ADPS2
	#elif defined Prescaler_4
		CLRB ADCSRA, ADPS0
		SETB ADCSRA, ADPS1
		CLRB ADCSRA, ADPS2
	#elif defined Prescaler_8
		SETB ADCSRA, ADPS0
		SETB ADCSRA, ADPS1
		CLRB ADCSRA, ADPS2
	#elif defined Prescaler_16
		CLRB ADCSRA, ADPS0
		CLRB ADCSRA, ADPS1
		SETB ADCSRA, ADPS2
	#elif defined Prescaler_32
		SETB ADCSRA, ADPS0
		CLRB ADCSRA, ADPS1
		SETB ADCSRA, ADPS2
	#elif defined Prescaler_64
		CLRB ADCSRA, ADPS0
		SETB ADCSRA, ADPS1
		SETB ADCSRA, ADPS2
	#elif defined Prescaler_128
		SETB ADCSRA, ADPS0
		SETB ADCSRA, ADPS1
		SETB ADCSRA, ADPS2
	#endif
.endm
