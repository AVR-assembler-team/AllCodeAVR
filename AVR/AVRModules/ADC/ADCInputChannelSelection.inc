.macro SingleEndedInputSet
	.if ctrl == 8 || ctrl == 48 || ctrl == 88 || ctrl == 168 || ctrl == 328
		.if @0 == ADC0
			CLRB ADMUX, MUX0
			CLRB ADMUX, MUX1
			CLRB ADMUX, MUX2
			CLRB ADMUX, MUX3
		.elif @0 == ADC1
			SETB ADMUX, MUX0
			CLRB ADMUX, MUX1
			CLRB ADMUX, MUX2
			CLRB ADMUX, MUX3
		.elif @0 == ADC2
			CLRB ADMUX, MUX0
			SETB ADMUX, MUX1
			CLRB ADMUX, MUX2
			CLRB ADMUX, MUX3
		.elif @0 == ADC3
			SETB ADMUX, MUX0
			SETB ADMUX, MUX1
			CLRB ADMUX, MUX2
			CLRB ADMUX, MUX3
		.elif @0 == ADC4
			CLRB ADMUX, MUX0
			CLRB ADMUX, MUX1
			SETB ADMUX, MUX2
			CLRB ADMUX, MUX3
		.elif @0 == ADC5
			SETB ADMUX, MUX0
			CLRB ADMUX, MUX1
			SETB ADMUX, MUX2
			CLRB ADMUX, MUX3
		.elif @0 == ADC6
			CLRB ADMUX, MUX0
			SETB ADMUX, MUX1
			SETB ADMUX, MUX2
			CLRB ADMUX, MUX3
		.elif @0 == ADC7
			SETB ADMUX, MUX0
			SETB ADMUX, MUX1
			SETB ADMUX, MUX2
			CLRB ADMUX, MUX3
		.elif @0 == VBG
			CLRB ADMUX, MUX0
			SETB ADMUX, MUX1
			SETB ADMUX, MUX2
			SETB ADMUX, MUX3
		.elif @0 == GND
			SETB ADMUX, MUX0
			SETB ADMUX, MUX1
			SETB ADMUX, MUX2
			SETB ADMUX, MUX3
		.else
			.error "This Single Ended Input is not supporting by this controller!"
		.endif
	.elif ctrl == 640 || ctrl == 1280 || ctrl == 1281 || ctrl == 2560 || ctrl == 2561
		.if @0 == ADC0
			CLRB ADMUX, MUX0
			CLRB ADMUX, MUX1
			CLRB ADMUX, MUX2
			CLRB ADMUX, MUX3
			CLRB ADMUX, MUX4
			CLRB ADCSRB, MUX5
		.elif @0 == ADC1
			SETB ADMUX, MUX0
			CLRB ADMUX, MUX1
			CLRB ADMUX, MUX2
			CLRB ADMUX, MUX3
			CLRB ADMUX, MUX4
			CLRB ADCSRB, MUX5
		.elif @0 == ADC2
			CLRB ADMUX, MUX0
			SETB ADMUX, MUX1
			CLRB ADMUX, MUX2
			CLRB ADMUX, MUX3
			CLRB ADMUX, MUX4
			CLRB ADCSRB, MUX5
		.elif @0 == ADC3
			SETB ADMUX, MUX0
			SETB ADMUX, MUX1
			CLRB ADMUX, MUX2
			CLRB ADMUX, MUX3
			CLRB ADMUX, MUX4
			CLRB ADCSRB, MUX5
		.elif @0 == ADC4
			CLRB ADMUX, MUX0
			CLRB ADMUX, MUX1
			SETB ADMUX, MUX2
			CLRB ADMUX, MUX3
			CLRB ADMUX, MUX4
			CLRB ADCSRB, MUX5
		.elif @0 == ADC5
			SETB ADMUX, MUX0
			CLRB ADMUX, MUX1
			SETB ADMUX, MUX2
			CLRB ADMUX, MUX3
			CLRB ADMUX, MUX4
			CLRB ADCSRB, MUX5
		.elif @0 == ADC6
			CLRB ADMUX, MUX0
			SETB ADMUX, MUX1
			SETB ADMUX, MUX2
			CLRB ADMUX, MUX3
			CLRB ADMUX, MUX4
			CLRB ADCSRB, MUX5
		.elif @0 == ADC7
			SETB ADMUX, MUX0
			SETB ADMUX, MUX1
			SETB ADMUX, MUX2
			CLRB ADMUX, MUX3
			CLRB ADMUX, MUX4
			CLRB ADCSRB, MUX5
		.elif @0 == VBG
			CLRB ADMUX, MUX0
			SETB ADMUX, MUX1
			SETB ADMUX, MUX2
			SETB ADMUX, MUX3
			SETB ADMUX, MUX4
			CLRB ADCSRB, MUX5
		.elif @0 == GND
			SETB ADMUX, MUX0
			SETB ADMUX, MUX1
			SETB ADMUX, MUX2
			SETB ADMUX, MUX3
			SETB ADMUX, MUX4
			CLRB ADCSRB, MUX5
		.elif @0 == ADC8
			CLRB ADMUX, MUX0
			CLRB ADMUX, MUX1
			CLRB ADMUX, MUX2
			CLRB ADMUX, MUX3
			CLRB ADMUX, MUX4
			SETB ADCSRB, MUX5
		.elif @0 == ADC9
			SETB ADMUX, MUX0
			CLRB ADMUX, MUX1
			CLRB ADMUX, MUX2
			CLRB ADMUX, MUX3
			CLRB ADMUX, MUX4
			SETB ADCSRB, MUX5
		.elif @0 == ADC10
			CLRB ADMUX, MUX0
			SETB ADMUX, MUX1
			CLRB ADMUX, MUX2
			CLRB ADMUX, MUX3
			CLRB ADMUX, MUX4
			SETB ADCSRB, MUX5
		.elif @0 == ADC11
			SETB ADMUX, MUX0
			SETB ADMUX, MUX1
			CLRB ADMUX, MUX2
			CLRB ADMUX, MUX3
			CLRB ADMUX, MUX4
			SETB ADCSRB, MUX5
		.elif @0 == ADC12
			CLRB ADMUX, MUX0
			CLRB ADMUX, MUX1
			SETB ADMUX, MUX2
			CLRB ADMUX, MUX3
			CLRB ADMUX, MUX4
			SETB ADCSRB, MUX5
		.elif @0 == ADC13
			SETB ADMUX, MUX0
			CLRB ADMUX, MUX1
			SETB ADMUX, MUX2
			CLRB ADMUX, MUX3
			CLRB ADMUX, MUX4
			SETB ADCSRB, MUX5
		.elif @0 == ADC14
			CLRB ADMUX, MUX0
			SETB ADMUX, MUX1
			SETB ADMUX, MUX2
			CLRB ADMUX, MUX3
			CLRB ADMUX, MUX4
			SETB ADCSRB, MUX5
		.elif @0 == ADC15
			SETB ADMUX, MUX0
			SETB ADMUX, MUX1
			SETB ADMUX, MUX2
			CLRB ADMUX, MUX3
			CLRB ADMUX, MUX4
			SETB ADCSRB, MUX5
		.endif
	.else
		.if @0 == ADC0
			CLRB ADMUX, MUX0
			CLRB ADMUX, MUX1
			CLRB ADMUX, MUX2
			CLRB ADMUX, MUX3
			CLRB ADMUX, MUX4
		.elif @0 == ADC1
			SETB ADMUX, MUX0
			CLRB ADMUX, MUX1
			CLRB ADMUX, MUX2
			CLRB ADMUX, MUX3
			CLRB ADMUX, MUX4
		.elif @0 == ADC2
			CLRB ADMUX, MUX0
			SETB ADMUX, MUX1
			CLRB ADMUX, MUX2
			CLRB ADMUX, MUX3
			CLRB ADMUX, MUX4
		.elif @0 == ADC3
			SETB ADMUX, MUX0
			SETB ADMUX, MUX1
			CLRB ADMUX, MUX2
			CLRB ADMUX, MUX3
			CLRB ADMUX, MUX4
		.elif @0 == ADC4
			CLRB ADMUX, MUX0
			CLRB ADMUX, MUX1
			SETB ADMUX, MUX2
			CLRB ADMUX, MUX3
			CLRB ADMUX, MUX4
		.elif @0 == ADC5
			SETB ADMUX, MUX0
			CLRB ADMUX, MUX1
			SETB ADMUX, MUX2
			CLRB ADMUX, MUX3
			CLRB ADMUX, MUX4
		.elif @0 == ADC6
			CLRB ADMUX, MUX0
			SETB ADMUX, MUX1
			SETB ADMUX, MUX2
			CLRB ADMUX, MUX3
			CLRB ADMUX, MUX4
		.elif @0 == ADC7
			SETB ADMUX, MUX0
			SETB ADMUX, MUX1
			SETB ADMUX, MUX2
			CLRB ADMUX, MUX3
			CLRB ADMUX, MUX4
		.elif @0 == VBG
			CLRB ADMUX, MUX0
			SETB ADMUX, MUX1
			SETB ADMUX, MUX2
			SETB ADMUX, MUX3
			SETB ADMUX, MUX4
		.elif @0 == GND
			SETB ADMUX, MUX0
			SETB ADMUX, MUX1
			SETB ADMUX, MUX2
			SETB ADMUX, MUX3
			SETB ADMUX, MUX4
		.else
			.error "This Single Ended Input is not supporting by this controller!"
		.endif
	.endif
.endm
// ==========================================================================================================
.macro DifferentialInputNoGain
	.if @0 == ADC0 && @1 == ADC1
			CLRB ADMUX, MUX0
			CLRB ADMUX, MUX1
			CLRB ADMUX, MUX2
			CLRB ADMUX, MUX3
			SETB ADMUX, MUX4
		.elif @0 == ADC1 && @1 == ADC1
			SETB ADMUX, MUX0
			CLRB ADMUX, MUX1
			CLRB ADMUX, MUX2
			CLRB ADMUX, MUX3
			SETB ADMUX, MUX4
		.elif @0 == ADC2 && @1 == ADC1
			CLRB ADMUX, MUX0
			SETB ADMUX, MUX1
			CLRB ADMUX, MUX2
			CLRB ADMUX, MUX3
			SETB ADMUX, MUX4
		.elif @0 == ADC3 && @1 == ADC1
			SETB ADMUX, MUX0
			SETB ADMUX, MUX1
			CLRB ADMUX, MUX2
			CLRB ADMUX, MUX3
			SETB ADMUX, MUX4
		.elif @0 == ADC4 && @1 == ADC1
			CLRB ADMUX, MUX0
			CLRB ADMUX, MUX1
			SETB ADMUX, MUX2
			CLRB ADMUX, MUX3
			SETB ADMUX, MUX4
		.elif @0 == ADC5 && @1 == ADC1
			SETB ADMUX, MUX0
			CLRB ADMUX, MUX1
			SETB ADMUX, MUX2
			CLRB ADMUX, MUX3
			SETB ADMUX, MUX4
		.elif @0 == ADC6 && @1 == ADC1
			CLRB ADMUX, MUX0
			SETB ADMUX, MUX1
			SETB ADMUX, MUX2
			CLRB ADMUX, MUX3
			SETB ADMUX, MUX4
		.elif @0 == ADC7 && @1 == ADC1
			SETB ADMUX, MUX0
			SETB ADMUX, MUX1
			SETB ADMUX, MUX2
			CLRB ADMUX, MUX3
			SETB ADMUX, MUX4
		.elif @0 == ADC0 && @1 == ADC2
			CLRB ADMUX, MUX0
			CLRB ADMUX, MUX1
			CLRB ADMUX, MUX2
			SETB ADMUX, MUX3
			SETB ADMUX, MUX4
		.elif @0 == ADC1 && @1 == ADC2
			SETB ADMUX, MUX0
			CLRB ADMUX, MUX1
			CLRB ADMUX, MUX2
			SETB ADMUX, MUX3
			SETB ADMUX, MUX4
		.elif @0 == ADC2 && @1 == ADC2
			CLRB ADMUX, MUX0
			SETB ADMUX, MUX1
			CLRB ADMUX, MUX2
			SETB ADMUX, MUX3
			SETB ADMUX, MUX4
		.elif @0 == ADC3 && @1 == ADC2
			SETB ADMUX, MUX0
			SETB ADMUX, MUX1
			CLRB ADMUX, MUX2
			SETB ADMUX, MUX3
			SETB ADMUX, MUX4
		.elif @0 == ADC4 && @1 == ADC2
			CLRB ADMUX, MUX0
			CLRB ADMUX, MUX1
			SETB ADMUX, MUX2
			SETB ADMUX, MUX3
			SETB ADMUX, MUX4
		.elif @0 == ADC5 && @1 == ADC2
			SETB ADMUX, MUX0
			CLRB ADMUX, MUX1
			SETB ADMUX, MUX2
			SETB ADMUX, MUX3
			SETB ADMUX, MUX4
		.else
			.error "Positive and Negative Differential Input combination is not supporting by this controller!"
		.endif
.endm
// ==========================================================================================================
.macro DifferentialInputGain
	.if ctrl == 16 || ctrl == 32 || ctrl == 64 || ctrl == 128 || ctrl == 164 || ctrl == 324 || ctrl == 644 || ctrl == 1284 || ctrl == 8535
		.if @0 == ADC0 &&  @1 == ADC0 && @2 == Gain10
			CLRB ADMUX, MUX0
			CLRB ADMUX, MUX1
			CLRB ADMUX, MUX2
			SETB ADMUX, MUX3
			CLRB ADMUX, MUX4
		.elif @0 == ADC1 &&  @1 == ADC0 && @2 == Gain10
			SETB ADMUX, MUX0
			CLRB ADMUX, MUX1
			CLRB ADMUX, MUX2
			SETB ADMUX, MUX3
			CLRB ADMUX, MUX4
		.elif @0 == ADC0 &&  @1 == ADC0 && @2 == Gain200
			CLRB ADMUX, MUX0
			SETB ADMUX, MUX1
			CLRB ADMUX, MUX2
			SETB ADMUX, MUX3
			CLRB ADMUX, MUX4
		.elif @0 == ADC1 &&  @1 == ADC0 && @2 == Gain200
			SETB ADMUX, MUX0
			SETB ADMUX, MUX1
			CLRB ADMUX, MUX2
			SETB ADMUX, MUX3
			CLRB ADMUX, MUX4
		.elif @0 == ADC2 &&  @1 == ADC2 && @2 == Gain10
			CLRB ADMUX, MUX0
			CLRB ADMUX, MUX1
			SETB ADMUX, MUX2
			SETB ADMUX, MUX3
			CLRB ADMUX, MUX4
		.elif @0 == ADC3 &&  @1 == ADC2 && @2 == Gain10
			SETB ADMUX, MUX0
			CLRB ADMUX, MUX1
			SETB ADMUX, MUX2
			SETB ADMUX, MUX3
			CLRB ADMUX, MUX4
		.elif @0 == ADC2 &&  @1 == ADC2 && @2 == Gain200
			CLRB ADMUX, MUX0
			SETB ADMUX, MUX1
			SETB ADMUX, MUX2
			SETB ADMUX, MUX3
			CLRB ADMUX, MUX4
		.elif @0 == ADC3 &&  @1 == ADC2 && @2 == Gain200
			SETB ADMUX, MUX0
			SETB ADMUX, MUX1
			SETB ADMUX, MUX2
			SETB ADMUX, MUX3
			CLRB ADMUX, MUX4
		.elif @0 == ADC0 &&  @1 == ADC1 && @2 == Gain1
			CLRB ADMUX, MUX0
			CLRB ADMUX, MUX1
			CLRB ADMUX, MUX2
			CLRB ADMUX, MUX3
			SETB ADMUX, MUX4
		.elif @0 == ADC1 &&  @1 == ADC1 && @2 == Gain1
			SETB ADMUX, MUX0
			CLRB ADMUX, MUX1
			CLRB ADMUX, MUX2
			CLRB ADMUX, MUX3
			SETB ADMUX, MUX4
		.elif @0 == ADC2 &&  @1 == ADC1 && @2 == Gain1
			CLRB ADMUX, MUX0
			SETB ADMUX, MUX1
			CLRB ADMUX, MUX2
			CLRB ADMUX, MUX3
			SETB ADMUX, MUX4
		.elif @0 == ADC3 &&  @1 == ADC1 && @2 == Gain1
			SETB ADMUX, MUX0
			SETB ADMUX, MUX1
			CLRB ADMUX, MUX2
			CLRB ADMUX, MUX3
			SETB ADMUX, MUX4
		.elif @0 == ADC4 &&  @1 == ADC1 && @2 == Gain1
			CLRB ADMUX, MUX0
			CLRB ADMUX, MUX1
			SETB ADMUX, MUX2
			CLRB ADMUX, MUX3
			SETB ADMUX, MUX4
		.elif @0 == ADC5 &&  @1 == ADC1 && @2 == Gain1
			SETB ADMUX, MUX0
			CLRB ADMUX, MUX1
			SETB ADMUX, MUX2
			CLRB ADMUX, MUX3
			SETB ADMUX, MUX4
		.elif @0 == ADC6 &&  @1 == ADC1 && @2 == Gain1
			CLRB ADMUX, MUX0
			SETB ADMUX, MUX1
			SETB ADMUX, MUX2
			CLRB ADMUX, MUX3
			SETB ADMUX, MUX4
		.elif @0 == ADC7 &&  @1 == ADC1 && @2 == Gain1
			SETB ADMUX, MUX0
			SETB ADMUX, MUX1
			SETB ADMUX, MUX2
			CLRB ADMUX, MUX3
			SETB ADMUX, MUX4
		.elif @0 == ADC0 &&  @1 == ADC2 && @2 == Gain1
			CLRB ADMUX, MUX0
			CLRB ADMUX, MUX1
			CLRB ADMUX, MUX2
			SETB ADMUX, MUX3
			SETB ADMUX, MUX4
		.elif @0 == ADC1 &&  @1 == ADC2 && @2 == Gain1
			SETB ADMUX, MUX0
			CLRB ADMUX, MUX1
			CLRB ADMUX, MUX2
			SETB ADMUX, MUX3
			SETB ADMUX, MUX4
		.elif @0 == ADC2 &&  @1 == ADC2 && @2 == Gain1
			CLRB ADMUX, MUX0
			SETB ADMUX, MUX1
			CLRB ADMUX, MUX2
			SETB ADMUX, MUX3
			SETB ADMUX, MUX4
		.elif @0 == ADC3 &&  @1 == ADC2 && @2 == Gain1
			SETB ADMUX, MUX0
			SETB ADMUX, MUX1
			CLRB ADMUX, MUX2
			SETB ADMUX, MUX3
			SETB ADMUX, MUX4
		.elif @0 == ADC4 &&  @1 == ADC2 && @2 == Gain1
			CLRB ADMUX, MUX0
			CLRB ADMUX, MUX1
			SETB ADMUX, MUX2
			SETB ADMUX, MUX3
			SETB ADMUX, MUX4
		.elif @0 == ADC5 &&  @1 == ADC2 && @2 == Gain1
			SETB ADMUX, MUX0
			CLRB ADMUX, MUX1
			SETB ADMUX, MUX2
			SETB ADMUX, MUX3
			SETB ADMUX, MUX4
		.else
			.error "Positive and Negative Differential Input combination is not supporting by this controller!"
		.endif
	.elif ctrl == 640 || ctrl == 1280 || ctrl == 1281 || ctrl == 2560 || ctrl == 2561
		.if @0 == ADC0 &&  @1 == ADC0 && @2 == Gain10
			CLRB ADMUX, MUX0
			CLRB ADMUX, MUX1
			CLRB ADMUX, MUX2
			SETB ADMUX, MUX3
			CLRB ADMUX, MUX4
			CLRB ADCSRB, MUX5
		.elif @0 == ADC1 &&  @1 == ADC0 && @2 == Gain10
			SETB ADMUX, MUX0
			CLRB ADMUX, MUX1
			CLRB ADMUX, MUX2
			SETB ADMUX, MUX3
			CLRB ADMUX, MUX4
			CLRB ADCSRB, MUX5
		.elif @0 == ADC0 &&  @1 == ADC0 && @2 == Gain200
			CLRB ADMUX, MUX0
			SETB ADMUX, MUX1
			CLRB ADMUX, MUX2
			SETB ADMUX, MUX3
			CLRB ADMUX, MUX4
			CLRB ADCSRB, MUX5
		.elif @0 == ADC1 &&  @1 == ADC0 && @2 == Gain200
			SETB ADMUX, MUX0
			SETB ADMUX, MUX1
			CLRB ADMUX, MUX2
			SETB ADMUX, MUX3
			CLRB ADMUX, MUX4
			CLRB ADCSRB, MUX5
		.elif @0 == ADC2 &&  @1 == ADC2 && @2 == Gain10
			CLRB ADMUX, MUX0
			CLRB ADMUX, MUX1
			SETB ADMUX, MUX2
			SETB ADMUX, MUX3
			CLRB ADMUX, MUX4
			CLRB ADCSRB, MUX5
		.elif @0 == ADC3 &&  @1 == ADC2 && @2 == Gain10
			SETB ADMUX, MUX0
			CLRB ADMUX, MUX1
			SETB ADMUX, MUX2
			SETB ADMUX, MUX3
			CLRB ADMUX, MUX4
			CLRB ADCSRB, MUX5
		.elif @0 == ADC2 &&  @1 == ADC2 && @2 == Gain200
			CLRB ADMUX, MUX0
			SETB ADMUX, MUX1
			SETB ADMUX, MUX2
			SETB ADMUX, MUX3
			CLRB ADMUX, MUX4
			CLRB ADCSRB, MUX5
		.elif @0 == ADC3 &&  @1 == ADC2 && @2 == Gain200
			SETB ADMUX, MUX0
			SETB ADMUX, MUX1
			SETB ADMUX, MUX2
			SETB ADMUX, MUX3
			CLRB ADMUX, MUX4
			CLRB ADCSRB, MUX5
		.elif @0 == ADC0 &&  @1 == ADC1 && @2 == Gain1
			CLRB ADMUX, MUX0
			CLRB ADMUX, MUX1
			CLRB ADMUX, MUX2
			CLRB ADMUX, MUX3
			SETB ADMUX, MUX4
			CLRB ADCSRB, MUX5
		.elif @0 == ADC1 &&  @1 == ADC1 && @2 == Gain1
			SETB ADMUX, MUX0
			CLRB ADMUX, MUX1
			CLRB ADMUX, MUX2
			CLRB ADMUX, MUX3
			SETB ADMUX, MUX4
			CLRB ADCSRB, MUX5
		.elif @0 == ADC2 &&  @1 == ADC1 && @2 == Gain1
			CLRB ADMUX, MUX0
			SETB ADMUX, MUX1
			CLRB ADMUX, MUX2
			CLRB ADMUX, MUX3
			SETB ADMUX, MUX4
			CLRB ADCSRB, MUX5
		.elif @0 == ADC3 &&  @1 == ADC1 && @2 == Gain1
			SETB ADMUX, MUX0
			SETB ADMUX, MUX1
			CLRB ADMUX, MUX2
			CLRB ADMUX, MUX3
			SETB ADMUX, MUX4
			CLRB ADCSRB, MUX5
		.elif @0 == ADC4 &&  @1 == ADC1 && @2 == Gain1
			CLRB ADMUX, MUX0
			CLRB ADMUX, MUX1
			SETB ADMUX, MUX2
			CLRB ADMUX, MUX3
			SETB ADMUX, MUX4
			CLRB ADCSRB, MUX5
		.elif @0 == ADC5 &&  @1 == ADC1 && @2 == Gain1
			SETB ADMUX, MUX0
			CLRB ADMUX, MUX1
			SETB ADMUX, MUX2
			CLRB ADMUX, MUX3
			SETB ADMUX, MUX4
			CLRB ADCSRB, MUX5
		.elif @0 == ADC6 &&  @1 == ADC1 && @2 == Gain1
			CLRB ADMUX, MUX0
			SETB ADMUX, MUX1
			SETB ADMUX, MUX2
			CLRB ADMUX, MUX3
			SETB ADMUX, MUX4
			CLRB ADCSRB, MUX5
		.elif @0 == ADC7 &&  @1 == ADC1 && @2 == Gain1
			SETB ADMUX, MUX0
			SETB ADMUX, MUX1
			SETB ADMUX, MUX2
			CLRB ADMUX, MUX3
			SETB ADMUX, MUX4
			CLRB ADCSRB, MUX5
		.elif @0 == ADC0 &&  @1 == ADC2 && @2 == Gain1
			CLRB ADMUX, MUX0
			CLRB ADMUX, MUX1
			CLRB ADMUX, MUX2
			SETB ADMUX, MUX3
			SETB ADMUX, MUX4
			CLRB ADCSRB, MUX5
		.elif @0 == ADC1 &&  @1 == ADC2 && @2 == Gain1
			SETB ADMUX, MUX0
			CLRB ADMUX, MUX1
			CLRB ADMUX, MUX2
			SETB ADMUX, MUX3
			SETB ADMUX, MUX4
			CLRB ADCSRB, MUX5
		.elif @0 == ADC2 &&  @1 == ADC2 && @2 == Gain1
			CLRB ADMUX, MUX0
			SETB ADMUX, MUX1
			CLRB ADMUX, MUX2
			SETB ADMUX, MUX3
			SETB ADMUX, MUX4
			CLRB ADCSRB, MUX5
		.elif @0 == ADC3 &&  @1 == ADC2 && @2 == Gain1
			SETB ADMUX, MUX0
			SETB ADMUX, MUX1
			CLRB ADMUX, MUX2
			SETB ADMUX, MUX3
			SETB ADMUX, MUX4
			CLRB ADCSRB, MUX5
		.elif @0 == ADC4 &&  @1 == ADC2 && @2 == Gain1
			CLRB ADMUX, MUX0
			CLRB ADMUX, MUX1
			SETB ADMUX, MUX2
			SETB ADMUX, MUX3
			SETB ADMUX, MUX4
			CLRB ADCSRB, MUX5
		.elif @0 == ADC5 &&  @1 == ADC2 && @2 == Gain1
			SETB ADMUX, MUX0
			CLRB ADMUX, MUX1
			SETB ADMUX, MUX2
			SETB ADMUX, MUX3
			SETB ADMUX, MUX4
			CLRB ADCSRB, MUX5
		.elif @0 == ADC8 &&  @1 == ADC8 && @2 == Gain10
			CLRB ADMUX, MUX0
			CLRB ADMUX, MUX1
			CLRB ADMUX, MUX2
			SETB ADMUX, MUX3
			CLRB ADMUX, MUX4
			SETB ADCSRB, MUX5
		.elif @0 == ADC9 &&  @1 == ADC8 && @2 == Gain10
			SETB ADMUX, MUX0
			CLRB ADMUX, MUX1
			CLRB ADMUX, MUX2
			SETB ADMUX, MUX3
			CLRB ADMUX, MUX4
			SETB ADCSRB, MUX5
		.elif @0 == ADC8 &&  @1 == ADC8 && @2 == Gain200
			CLRB ADMUX, MUX0
			SETB ADMUX, MUX1
			CLRB ADMUX, MUX2
			SETB ADMUX, MUX3
			CLRB ADMUX, MUX4
			SETB ADCSRB, MUX5
		.elif @0 == ADC9 &&  @1 == ADC8 && @2 == Gain200
			SETB ADMUX, MUX0
			SETB ADMUX, MUX1
			CLRB ADMUX, MUX2
			SETB ADMUX, MUX3
			CLRB ADMUX, MUX4
			SETB ADCSRB, MUX5
		.elif @0 == ADC10 &&  @1 == ADC10 && @2 == Gain10
			CLRB ADMUX, MUX0
			CLRB ADMUX, MUX1
			SETB ADMUX, MUX2
			SETB ADMUX, MUX3
			CLRB ADMUX, MUX4
			SETB ADCSRB, MUX5
		.elif @0 == ADC11 &&  @1 == ADC10 && @2 == Gain10
			SETB ADMUX, MUX0
			CLRB ADMUX, MUX1
			SETB ADMUX, MUX2
			SETB ADMUX, MUX3
			CLRB ADMUX, MUX4
			SETB ADCSRB, MUX5
		.elif @0 == ADC10 &&  @1 == ADC10 && @2 == Gain200
			CLRB ADMUX, MUX0
			SETB ADMUX, MUX1
			SETB ADMUX, MUX2
			SETB ADMUX, MUX3
			CLRB ADMUX, MUX4
			SETB ADCSRB, MUX5
		.elif @0 == ADC11 &&  @1 == ADC10 && @2 == Gain200
			SETB ADMUX, MUX0
			SETB ADMUX, MUX1
			SETB ADMUX, MUX2
			SETB ADMUX, MUX3
			CLRB ADMUX, MUX4
			SETB ADCSRB, MUX5
		.elif @0 == ADC8 &&  @1 == ADC9 && @2 == Gain1
			CLRB ADMUX, MUX0
			CLRB ADMUX, MUX1
			CLRB ADMUX, MUX2
			CLRB ADMUX, MUX3
			SETB ADMUX, MUX4
			SETB ADCSRB, MUX5
		.elif @0 == ADC9 &&  @1 == ADC9 && @2 == Gain1
			SETB ADMUX, MUX0
			CLRB ADMUX, MUX1
			CLRB ADMUX, MUX2
			CLRB ADMUX, MUX3
			SETB ADMUX, MUX4
			SETB ADCSRB, MUX5
		.elif @0 == ADC10 &&  @1 == ADC9 && @2 == Gain1
			CLRB ADMUX, MUX0
			SETB ADMUX, MUX1
			CLRB ADMUX, MUX2
			CLRB ADMUX, MUX3
			SETB ADMUX, MUX4
			SETB ADCSRB, MUX5
		.elif @0 == ADC11 &&  @1 == ADC9 && @2 == Gain1
			SETB ADMUX, MUX0
			SETB ADMUX, MUX1
			CLRB ADMUX, MUX2
			CLRB ADMUX, MUX3
			SETB ADMUX, MUX4
			SETB ADCSRB, MUX5
		.elif @0 == ADC12 &&  @1 == ADC9 && @2 == Gain1
			CLRB ADMUX, MUX0
			CLRB ADMUX, MUX1
			SETB ADMUX, MUX2
			CLRB ADMUX, MUX3
			SETB ADMUX, MUX4
			SETB ADCSRB, MUX5
		.elif @0 == ADC13 &&  @1 == ADC9 && @2 == Gain1
			SETB ADMUX, MUX0
			CLRB ADMUX, MUX1
			SETB ADMUX, MUX2
			CLRB ADMUX, MUX3
			SETB ADMUX, MUX4
			SETB ADCSRB, MUX5
		.elif @0 == ADC14 &&  @1 == ADC9 && @2 == Gain1
			CLRB ADMUX, MUX0
			SETB ADMUX, MUX1
			SETB ADMUX, MUX2
			CLRB ADMUX, MUX3
			SETB ADMUX, MUX4
			SETB ADCSRB, MUX5
		.elif @0 == ADC15 &&  @1 == ADC9 && @2 == Gain1
			SETB ADMUX, MUX0
			SETB ADMUX, MUX1
			SETB ADMUX, MUX2
			CLRB ADMUX, MUX3
			SETB ADMUX, MUX4
			SETB ADCSRB, MUX5
		.elif @0 == ADC8 &&  @1 == ADC10 && @2 == Gain1
			CLRB ADMUX, MUX0
			CLRB ADMUX, MUX1
			CLRB ADMUX, MUX2
			SETB ADMUX, MUX3
			SETB ADMUX, MUX4
			SETB ADCSRB, MUX5
		.elif @0 == ADC9 &&  @1 == ADC10 && @2 == Gain1
			SETB ADMUX, MUX0
			CLRB ADMUX, MUX1
			CLRB ADMUX, MUX2
			SETB ADMUX, MUX3
			SETB ADMUX, MUX4
			SETB ADCSRB, MUX5
		.elif @0 == ADC10 &&  @1 == ADC10 && @2 == Gain1
			CLRB ADMUX, MUX0
			SETB ADMUX, MUX1
			CLRB ADMUX, MUX2
			SETB ADMUX, MUX3
			SETB ADMUX, MUX4
			SETB ADCSRB, MUX5
		.elif @0 == ADC11 &&  @1 == ADC10 && @2 == Gain1
			SETB ADMUX, MUX0
			SETB ADMUX, MUX1
			CLRB ADMUX, MUX2
			SETB ADMUX, MUX3
			SETB ADMUX, MUX4
			SETB ADCSRB, MUX5
		.elif @0 == ADC12 &&  @1 == ADC10 && @2 == Gain1
			CLRB ADMUX, MUX0
			CLRB ADMUX, MUX1
			SETB ADMUX, MUX2
			SETB ADMUX, MUX3
			SETB ADMUX, MUX4
			SETB ADCSRB, MUX5
		.elif @0 == ADC13 &&  @1 == ADC10 && @2 == Gain1
			SETB ADMUX, MUX0
			CLRB ADMUX, MUX1
			SETB ADMUX, MUX2
			SETB ADMUX, MUX3
			SETB ADMUX, MUX4
			SETB ADCSRB, MUX5
		.else
			.error "Positive and Negative Differential Input combination is not supporting by this controller!"
		.endif
	.endif
.endm
// ==========================================================================================================
.macro ADCInputChannelSelection
	.if ctrl == 162 || ctrl == 8515
		.error "ADC is not supporting by this controller!"
	.else
		.if @0 == SingleEndedInput
			SingleEndedInputSet @1
		.elif @0 == DifferentialInput
			.if ctrl == 8 || ctrl == 48 || ctrl == 88 || ctrl == 168 || ctrl == 328
				.error "Differential Input is not supporting by this controller!"
			.else
				.if ctrl == 165 || ctrl == 169 || ctrl == 325 || ctrl == 3250 || ctrl == 645 || ctrl == 6450 || ctrl == 329 || ctrl == 3290 || ctrl == 649 || ctrl == 6490
					DifferentialInputNoGain @1, @2
				.else
					DifferentialInputGain @1, @2, @3
				.endif
			.endif
		.else
			.error "Only Single Ended Input mode and Differential Input mode are available!"
		.endif
	.endif
.endm
