; Укажите на какой частоте будет работать микроконтроллер
.equ ATmegaFREQ = 16000000		;частота работы чипа в Гц

; Выберите микроконтроллер
//.include	"m8Adef.inc"
//.include	"m8def.inc"
//.include	"m8HVAdef.inc"
//.include	"m8U2def.inc"
//.include	"m16Adef.inc"
//.include	"m16def.inc"
//.include	"m16HVAdef.inc"
//.include	"m16HVBdef.inc"
//.include	"m16HVBrevBdef.inc"
//.include	"m16M1def.inc"
//.include	"m16U2def.inc"
//.include	"m16U4def.inc"
//.include	"m32Adef.inc"
//.include	"m32C1def.inc"
//.include	"m32def.inc"
//.include	"m32HVBdef.inc"
//.include	"m32HVBrevBdef.inc"
//.include	"m32M1def.inc"
//.include	"m32U2def.inc"
//.include	"m32U4def.inc"
//.include	"m48Adef.inc"
//.include	"m48def.inc"
//.include	"m48PAdef.inc"
//.include	"m48PBdef.inc"
//.include	"m48Pdef.inc"
//.include	"m64Adef.inc"
//.include	"m64C1def.inc"
//.include	"m64def.inc"
//.include	"m64HVE2def.inc"
//.include	"m64M1def.inc"
//.include	"m64RFR2def.inc"
//.include	"m88Adef.inc"
//.include	"m88def.inc"
//.include	"m88PAdef.inc"
//.include	"m88PBdef.inc"
//.include	"m88Pdef.inc"
//.include	"m128Adef.inc"
//.include	"m128def.inc"
//.include	"m128RFA1def.inc"
//.include	"m128RFR2def.inc"
//.include	"m162def.inc"
//.include	"m164Adef.inc"
//.include	"m164PAdef.inc"
//.include	"m164Pdef.inc"
//.include	"m165Adef.inc"
//.include	"m165PAdef.inc"
//.include	"m165Pdef.inc"
//.include	"m168Adef.inc"
//.include	"m168def.inc"
//.include	"m168PAdef.inc"
//.include	"m168PBdef.inc"
//.include	"m168Pdef.inc"
//.include	"m169Adef.inc"
//.include	"m169PAdef.inc"
//.include	"m169Pdef.inc"
//.include	"m256RFR2def.inc"
//.include	"m324Adef.inc"
//.include	"m324PAdef.inc"
//.include	"m324PBdef.inc"
//.include	"m324Pdef.inc"
//.include	"m325Adef.inc"
//.include	"m325def.inc"
//.include	"m325PAdef.inc"
//.include	"m325Pdef.inc"
//.include	"m328def.inc"
//.include	"m328PBdef.inc"
//.include	"m328Pdef.inc"
//.include	"m329Adef.inc"
//.include	"m329def.inc"
//.include	"m329PAdef.inc"
//.include	"m329Pdef.inc"
//.include	"m406def.inc"
//.include	"m640def.inc"
//.include	"m644Adef.inc"
//.include	"m644def.inc"
//.include	"m644PAdef.inc"
//.include	"m644Pdef.inc"
//.include	"m644RFR2def.inc"
//.include	"m645Adef.inc"
//.include	"m645def.inc"
//.include	"m645Pdef.inc"
//.include	"m649Adef.inc"
//.include	"m649def.inc"
//.include	"m649Pdef.inc"
//.include	"m808def.inc"
//.include	"m809def.inc"
//.include	"m1280def.inc"
//.include	"m1281def.inc"
//.include	"m1284def.inc"
//.include	"m1284Pdef.inc"
//.include	"m1284RFR2def.inc"
//.include	"m1608def.inc"
//.include	"m1609def.inc"
.include	"m2560def.inc"
//.include	"m2561def.inc"
//.include	"m2564RFR2def.inc"
//.include	"m3208def.inc"
//.include	"m3209def.inc"
//.include	"m3250Adef.inc"
//.include	"m3250def.inc"
//.include	"m3250PAdef.inc"
//.include	"m3250Pdef.inc"
//.include	"m3290Adef.inc"
//.include	"m3290def.inc"
//.include	"m3290PAdef.inc"
//.include	"m3290Pdef.inc"
//.include	"m4808def.inc"
//.include	"m4809def.inc"
//.include	"m6450Adef.inc"
//.include	"m6450def.inc"
//.include	"m6450Pdef.inc"
//.include	"m6490Adef.inc"
//.include	"m6490def.inc"
//.include	"m6490Pdef.inc"
//.include	"m8515def.inc"
//.include	"m8535def.inc"


// Выберите те модули, которые вам нужны для вашего проекта
// остальные закоментируйте

#define TWSI_Module
//#define HD44780U_Module
//#define USART_Module
//#define ADC_Module
#define ExternalInterrupts_Module
//#define RotaryEncoder_Module
//#define OneWire_Module
//#define NTC3950_100K_Module
#define PCF8575_Module
